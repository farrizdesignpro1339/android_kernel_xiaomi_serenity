// SPDX-License-Identifier: GPL-2.0-only
/*
 * ums9230-serenity-tp.dtsi - Xiaomi Redmi A5 (serenity) touchscreen
 * SPI3 @ CS0, IRQ GPIO144, RESET GPIO145
 * Extracted from stock VGWIDXM dtbo fragment@0 (targets &spi3)
 */
&spi3 {
	status = "ok";
	#address-cells = <1>;
	#size-cells = <0>;

	touch@0 {
		compatible = "c3z,NVT-ts-spi", "omnivision,tcm-spi", "focaltech,fts";
		reg = <0x00>;
		status = "ok";
		spi-max-frequency = <0x927c00>;
		spi-cs-setup-delay-ns = <0x12c>;
		spi-cs-hold-delay-ns = <0x12c>;
		focaltech,reset-gpio = <&ap_gpio 0x91 0x00>;
		focaltech,irq-gpio = <&ap_gpio 0x90 0x2001>;
		focaltech,max-touch-number = <0x0a>;
		focaltech,display-coords = <0x00 0x00 0x2d0 0x668>;
		omnivision,bus-reg-name = "vdd";
		omnivision,pwr-reg-name = "avdd";
		omnivision,irq-gpio = <&ap_gpio 0x90 0x2001>;
		omnivision,irq-on-state = <0x00>;
		omnivision,reset-gpio = <&ap_gpio 0x91 0x00>;
		omnivision,reset-on-state = <0x00>;
		omnivision,reset-active-ms = <0x14>;
		omnivision,reset-delay-ms = <0xc8>;
		omnivision,power-delay-ms = <0xc8>;
		omnivision,spi-mode = <0x03>;
		omnivision,byte-delay-us = <0x00>;
		omnivision,block-delay-us = <0x00>;
		omnivision,ubl-max-freq = <0x2dc6c0>;
		omnivision,ubl-byte-delay-us = <0x14>;
		novatek,reset-gpio = <&ap_gpio 0x91 0x00>;
		novatek,irq-gpio = <&ap_gpio 0x90 0x2001>;
		novatek,mp-support-dt;

		novatek-mp-criteria-599D@0 {
			#address-cells = <0x01>;
			#size-cells = <0x00>;
			compatible = "novatek-mp-criteria-599D";
			IC_X_CFG_SIZE = <0x12>;
			IC_Y_CFG_SIZE = <0x20>;
			IC_KEY_CFG_SIZE = <0x04>;
			X_Channel = <0x12>;
			Y_Channel = <0x20>;
			AIN_X = <0x00 0x01 0x02 0x03 0x04 0x05 0x06 0x07 0x08 0x09 0x0a 0x0b 0x0c 0x0d 0x0e 0x0f 0x10 0x11>;
			AIN_Y = <0x00 0x01 0x02 0x03 0x04 0x05 0x06 0x07 0x08 0x09 0x0a 0x0b 0x0c 0x0d 0x0e 0x0f 0x10 0x11 0x12 0x13 0x14 0x15 0x16 0x17 0x18 0x19 0x1a 0x1b 0x1c 0x1d 0x1e 0x1f>;
			AIN_KEY = <0x00 0x01 0x02 0xff>;
			PS_Config_Lmt_Short_Rawdata_P = <0x36b8 0x36b8 0x36b8 0x36b8 0x36b8 0x36b8 0x36b8 0x36b8 0x36b8 0x36b8 0x36b8 0x36b8 0x36b8 0x36b8 0x36b8 0x36b8 0x36b8 0x36b8 0x36b8 0x36b8 0x36b8 0x36b8 0x36b8 0x36b8 0x36b8 0x36b8 0x36b8 0x36b8 0x36b8 0x36b8 0x36b8 0x36b8 0x36b8 0x36b8 0x36b8 0x36b8 0x36b8 0x36b8 0x36b8 0x36b8 0x36b8 0x36b8 0x36b8 0x36b8 0x36b8 0x36b8 0x36b8 0x36b8 0x36b8 0x36b8 0x36b8 0x36b8 0x36b8 0x36b8 0x36b8 0x36b8 0x36b8 0x36b8 0x36b8 0x36b8 0x36b8 0x36b8 0x36b8 0x36b8 0x36b8 0x36b8 0x36b8 0x36b8 0x36b8 0x36b8 0x36b8 0x36b8 0x36b8 0x36b8 0x36b8 0x36b8 0x36b8 0x36b8 0x36b8 0x36b8 0x36b8 0x36b8 0x36b8 0x36b8 0x36b8 0x36b8 0x36b8 0x36b8 0x36b8 0x36b8 0x36b8 0x36b8 0x36b8 0x36b8 0x36b8 0x36b8 0x36b8 0x36b8 0x36b8 0x36b8 0x36b8 0x36b8 0x36b8 0x36b8 0x36b8 0x36b8 0x36b8 0x36b8 0x36b8 0x36b8 0x36b8 0x36b8 0x36b8 0x36b8 0x36b8 0x36b8 0x36b8 0x36b8 0x36b8 0x36b8 0x36b8 0x36b8 0x36b8 0x36b8 0x36b8 0x36b8 0x36b8 0x36b8 0x36b8 0x36b8 0x36b8 0x36b8 0x36b8 0x36b8 0x36b8 0x36b8 0x36b8 0x36b8 0x36b8 0x36b8 0x36b8 0x36b8 0x36b8 0x36b8 0x36b8 0x36b8 0x36b8 0x36b8 0x36b8 0x36b8 0x36b8 0x36b8 0x36b8 0x36b8 0x36b8 0x36b8 0x36b8 0x36b8 0x36b8 0x36b8 0x36b8 0x36b8 0x36b8 0x36b8 0x36b8 0x36b8 0x36b8 0x36b8 0x36b8 0x36b8 0x36b8 0x36b8 0x36b8 0x36b8 0x36b8 0x36b8 0x36b8 0x36b8 0x36b8 0x36b8 0x36b8 0x36b8 0x36b8 0x36b8 0x36b8 0x36b8 0x36b8 0x36b8 0x36b8 0x36b8 0x36b8 0x36b8 0x36b8 0x36b8 0x36b8 0x36b8 0x36b8 0x36b8 0x36b8 0x36b8 0x36b8 0x36b8 0x36b8 0x36b8 0x36b8 0x36b8 0x36b8 0x36b8 0x36b8 0x36b8 0x36b8 0x36b8 0x36b8 0x36b8 0x36b8 0x36b8 0x36b8 0x36b8 0x36b8 0x36b8 0x36b8 0x36b8 0x36b8 0x36b8 0x36b8 0x36b8 0x36b8 0x36b8 0x36b8 0x36b8 0x36b8 0x36b8 0x36b8 0x36b8 0x36b8 0x36b8 0x36b8 0x36b8 0x36b8 0x36b8 0x36b8 0x36b8 0x36b8 0x36b8 0x36b8 0x36b8 0x36b8 0x36b8 0x36b8 0x36b8 0x36b8 0x36b8 0x36b8 0x36b8 0x36b8 0x36b8 0x36b8 0x36b8 0x36b8 0x36b8 0x36b8 0x36b8 0x36b8 0x36b8 0x36b8 0x36b8 0x36b8 0x36b8 0x36b8 0x36b8 0x36b8 0x36b8 0x36b8 0x36b8 0x36b8 0x36b8 0x36b8 0x36b8 0x36b8 0x36b8 0x36b8 0x36b8 0x36b8 0x36b8 0x36b8 0x36b8 0x36b8 0x36b8 0x36b8 0x36b8 0x36b8 0x36b8 0x36b8 0x36b8 0x36b8 0x36b8 0x36b8 0x36b8 0x36b8 0x36b8 0x36b8 0x36b8 0x36b8 0x36b8 0x36b8 0x36b8 0x36b8 0x36b8 0x36b8 0x36b8 0x36b8 0x36b8 0x36b8 0x36b8 0x36b8 0x36b8 0x36b8 0x36b8 0x36b8 0x36b8 0x36b8 0x36b8 0x36b8 0x36b8 0x36b8 0x36b8 0x36b8 0x36b8 0x36b8 0x36b8 0x36b8 0x36b8 0x36b8 0x36b8 0x36b8 0x36b8 0x36b8 0x36b8 0x36b8 0x36b8 0x36b8 0x36b8 0x36b8 0x36b8 0x36b8 0x36b8 0x36b8 0x36b8 0x36b8 0x36b8 0x36b8 0x36b8 0x36b8 0x36b8 0x36b8 0x36b8 0x36b8 0x36b8 0x36b8 0x36b8 0x36b8 0x36b8 0x36b8 0x36b8 0x36b8 0x36b8 0x36b8 0x36b8 0x36b8 0x36b8 0x36b8 0x36b8 0x36b8 0x36b8 0x36b8 0x36b8 0x36b8 0x36b8 0x36b8 0x36b8 0x36b8 0x36b8 0x36b8 0x36b8 0x36b8 0x36b8 0x36b8 0x36b8 0x36b8 0x36b8 0x36b8 0x36b8 0x36b8 0x36b8 0x36b8 0x36b8 0x36b8 0x36b8 0x36b8 0x36b8 0x36b8 0x36b8 0x36b8 0x36b8 0x36b8 0x36b8 0x36b8 0x36b8 0x36b8 0x36b8 0x36b8 0x36b8 0x36b8 0x36b8 0x36b8 0x36b8 0x36b8 0x36b8 0x36b8 0x36b8 0x36b8 0x36b8 0x36b8 0x36b8 0x36b8 0x36b8 0x36b8 0x36b8 0x36b8 0x36b8 0x36b8 0x36b8 0x36b8 0x36b8 0x36b8 0x36b8 0x36b8 0x36b8 0x36b8 0x36b8 0x36b8 0x36b8 0x36b8 0x36b8 0x36b8 0x36b8 0x36b8 0x36b8 0x36b8 0x36b8 0x36b8 0x36b8 0x36b8 0x36b8 0x36b8 0x36b8 0x36b8 0x36b8 0x36b8 0x36b8 0x36b8 0x36b8 0x36b8 0x36b8 0x36b8 0x36b8 0x36b8 0x36b8 0x36b8 0x36b8 0x36b8 0x36b8 0x36b8 0x36b8 0x36b8 0x36b8 0x36b8 0x36b8 0x36b8 0x36b8 0x36b8 0x36b8 0x36b8 0x36b8 0x36b8 0x36b8 0x36b8 0x36b8 0x36b8 0x36b8 0x36b8 0x36b8 0x36b8 0x36b8 0x36b8 0x36b8 0x36b8 0x36b8 0x36b8 0x36b8 0x36b8 0x36b8 0x36b8 0x36b8 0x36b8 0x36b8 0x36b8 0x36b8 0x36b8 0x36b8 0x36b8 0x36b8 0x36b8 0x36b8 0x36b8 0x36b8 0x36b8 0x36b8 0x36b8 0x36b8 0x36b8 0x36b8 0x36b8 0x36b8 0x36b8 0x36b8 0x36b8 0x36b8 0x36b8 0x36b8 0x36b8 0x36b8 0x36b8 0x36b8 0x36b8 0x36b8 0x36b8 0x36b8 0x36b8 0x36b8 0x36b8 0x36b8 0x36b8 0x36b8 0x36b8 0x36b8 0x36b8 0x36b8 0x36b8 0x36b8 0x36b8 0x36b8 0x36b8 0x36b8 0x36b8 0x36b8 0x36b8 0x36b8 0x36b8 0x36b8 0x36b8 0x36b8 0x36b8 0x36b8 0x36b8 0x36b8 0x36b8 0x36b8 0x36b8 0x36b8 0x36b8 0x36b8 0x36b8 0x36b8 0x36b8 0x36b8 0x36b8 0x36b8 0x36b8>;
			PS_Config_Lmt_Short_Rawdata_N = <0x2774 0x2774 0x2774 0x2774 0x2774 0x2774 0x2774 0x2774 0x2774 0x2774 0x2774 0x2774 0x2774 0x2774 0x2774 0x2774 0x2774 0x2774 0x2774 0x2774 0x2774 0x2774 0x2774 0x2774 0x2774 0x2774 0x2774 0x2774 0x2774 0x2774 0x2774 0x2774 0x2774 0x2774 0x2774 0x2774 0x2774 0x2774 0x2774 0x2774 0x2774 0x2774 0x2774 0x2774 0x2774 0x2774 0x2774 0x2774 0x2774 0x2774 0x2774 0x2774 0x2774 0x2774 0x2774 0x2774 0x2774 0x2774 0x2774 0x2774 0x2774 0x2774 0x2774 0x2774 0x2774 0x2774 0x2774 0x2774 0x2774 0x2774 0x2774 0x2774 0x2774 0x2774 0x2774 0x2774 0x2774 0x2774 0x2774 0x2774 0x2774 0x2774 0x2774 0x2774 0x2774 0x2774 0x2774 0x2774 0x2774 0x2774 0x2774 0x2774 0x2774 0x2774 0x2774 0x2774 0x2774 0x2774 0x2774 0x2774 0x2774 0x2774 0x2774 0x2774 0x2774 0x2774 0x2774 0x2774 0x2774 0x2774 0x2774 0x2774 0x2774 0x2774 0x2774 0x2774 0x2774 0x2774 0x2774 0x2774 0x2774 0x2774 0x2774 0x2774 0x2774 0x2774 0x2774 0x2774 0x2774 0x2774 0x2774 0x2774 0x2774 0x2774 0x2774 0x2774 0x2774 0x2774 0x2774 0x2774 0x2774 0x2774 0x2774 0x2774 0x2774 0x2774 0x2774 0x2774 0x2774 0x2774 0x2774 0x2774 0x2774 0x2774 0x2774 0x2774 0x2774 0x2774 0x2774 0x2774 0x2774 0x2774 0x2774 0x2774 0x2774 0x2774 0x2774 0x2774 0x2774 0x2774 0x2774 0x2774 0x2774 0x2774 0x2774 0x2774 0x2774 0x2774 0x2774 0x2774 0x2774 0x2774 0x2774 0x2774 0x2774 0x2774 0x2774 0x2774 0x2774 0x2774 0x2774 0x2774 0x2774 0x2774 0x2774 0x2774 0x2774 0x2774 0x2774 0x2774 0x2774 0x2774 0x2774 0x2774 0x2774 0x2774 0x2774 0x2774 0x2774 0x2774 0x2774 0x2774 0x2774 0x2774 0x2774 0x2774 0x2774 0x2774 0x2774 0x2774 0x2774 0x2774 0x2774 0x2774 0x2774 0x2774 0x2774 0x2774 0x2774 0x2774 0x2774 0x2774 0x2774 0x2774 0x2774 0x2774 0x2774 0x2774 0x2774 0x2774 0x2774 0x2774 0x2774 0x2774 0x2774 0x2774 0x2774 0x2774 0x2774 0x2774 0x2774 0x2774 0x2774 0x2774 0x2774 0x2774 0x2774 0x2774 0x2774 0x2774 0x2774 0x2774 0x2774 0x2774 0x2774 0x2774 0x2774 0x2774 0x2774 0x2774 0x2774 0x2774 0x2774 0x2774 0x2774 0x2774 0x2774 0x2774 0x2774 0x2774 0x2774 0x2774 0x2774 0x2774 0x2774 0x2774 0x2774 0x2774 0x2774 0x2774 0x2774 0x2774 0x2774 0x2774 0x2774 0x2774 0x2774 0x2774 0x2774 0x2774 0x2774 0x2774 0x2774 0x2774 0x2774 0x2774 0x2774 0x2774 0x2774 0x2774 0x2774 0x2774 0x2774 0x2774 0x2774 0x2774 0x2774 0x2774 0x2774 0x2774 0x2774 0x2774 0x2774 0x2774 0x2774 0x2774 0x2774 0x2774 0x2774 0x2774 0x2774 0x2774 0x2774 0x2774 0x2774 0x2774 0x2774 0x2774 0x2774 0x2774 0x2774 0x2774 0x2774 0x2774 0x2774 0x2774 0x2774 0x2774 0x2774 0x2774 0x2774 0x2774 0x2774 0x2774 0x2774 0x2774 0x2774 0x2774 0x2774 0x2774 0x2774 0x2774 0x2774 0x2774 0x2774 0x2774 0x2774 0x2774 0x2774 0x2774 0x2774 0x2774 0x2774 0x2774 0x2774 0x2774 0x2774 0x2774 0x2774 0x2774 0x2774 0x2774 0x2774 0x2774 0x2774 0x2774 0x2774 0x2774 0x2774 0x2774 0x2774 0x2774 0x2774 0x2774 0x2774 0x2774 0x2774 0x2774 0x2774 0x2774 0x2774 0x2774 0x2774 0x2774 0x2774 0x2774 0x2774 0x2774 0x2774 0x2774 0x2774 0x2774 0x2774 0x2774 0x2774 0x2774 0x2774 0x2774 0x2774 0x2774 0x2774 0x2774 0x2774 0x2774 0x2774 0x2774 0x2774 0x2774 0x2774 0x2774 0x2774 0x2774 0x2774 0x2774 0x2774 0x2774 0x2774 0x2774 0x2774 0x2774 0x2774 0x2774 0x2774 0x2774 0x2774 0x2774 0x2774 0x2774 0x2774 0x2774 0x2774 0x2774 0x2774 0x2774 0x2774 0x2774 0x2774 0x2774 0x2774 0x2774 0x2774 0x2774 0x2774 0x2774 0x2774 0x2774 0x2774 0x2774 0x2774 0x2774 0x2774 0x2774 0x2774 0x2774 0x2774 0x2774 0x2774 0x2774 0x2774 0x2774 0x2774 0x2774 0x2774 0x2774 0x2774 0x2774 0x2774 0x2774 0x2774 0x2774 0x2774 0x2774 0x2774 0x2774 0x2774 0x2774 0x2774 0x2774 0x2774 0x2774 0x2774 0x2774 0x2774 0x2774 0x2774 0x2774 0x2774 0x2774 0x2774 0x2774 0x2774 0x2774 0x2774 0x2774 0x2774 0x2774 0x2774 0x2774 0x2774 0x2774 0x2774 0x2774 0x2774 0x2774 0x2774 0x2774 0x2774 0x2774 0x2774 0x2774 0x2774 0x2774 0x2774 0x2774 0x2774 0x2774 0x2774 0x2774 0x2774 0x2774 0x2774 0x2774 0x2774 0x2774 0x2774 0x2774 0x2774 0x2774 0x2774 0x2774 0x2774 0x2774 0x2774 0x2774 0x2774 0x2774 0x2774 0x2774 0x2774 0x2774 0x2774 0x2774 0x2774 0x2774 0x2774 0x2774 0x2774 0x2774 0x2774 0x2774 0x2774 0x2774 0x2774 0x2774 0x2774 0x2774 0x2710 0x2710 0x2710>;
			PS_Config_Lmt_Open_Rawdata_P = <0x9b6 0x9a3 0x983 0x967 0x942 0x925 0x926 0x8dc 0xffff 0xffff 0x8b1 0x8eb 0x8eb 0x8f5 0x902 0x90c 0x923 0x96f 0x9e5 0x9e5 0x9d0 0x9c2 0x9a7 0x98a 0x97c 0x95e 0x948 0x8f7 0x909 0x91b 0x928 0x938 0x93e 0x93d 0x94d 0x98e 0xa1e 0xa24 0xa11 0xa06 0x9f0 0x9d4 0x9bd 0x9a4 0x98f 0x90d 0x91f 0x930 0x93a 0x94b 0x94f 0x946 0x957 0x996 0xa05 0xa1d 0xa06 0x9f5 0x9de 0x9bf 0x9ad 0x993 0x979 0x92f 0x944 0x952 0x961 0x96e 0x975 0x973 0x987 0x9c2 0xa42 0xa65 0xa4f 0xa40 0xa28 0xa08 0x9f1 0x9d8 0x9bc 0x959 0x969 0x97d 0x988 0x99d 0x99f 0x996 0x9a6 0x9e0 0xa83 0xab0 0xa99 0xa87 0xa6b 0xa4f 0xa3d 0xa21 0xa06 0x977 0x988 0x99f 0x9a8 0x9bc 0x9c0 0x9b9 0x9ce 0xa03 0xa50 0xa1e 0x9f0 0x9df 0x9bf 0x99c 0x996 0x97d 0x96c 0x9d0 0x9e0 0x9f4 0x9f4 0xa02 0xa0c 0xa09 0xa37 0xa08 0xa68 0xa2f 0xa0a 0x9fb 0x9e0 0x9c6 0x9c0 0x9aa 0x999 0x9f4 0xa05 0xa13 0xa1a 0xa2b 0xa32 0xa33 0xa5a 0xa37 0xaa2 0xa63 0xa3e 0xa2c 0xa0d 0x9f0 0x9e9 0x9d2 0x9bf 0xa1d 0xa2b 0xa3d 0xa3d 0xa4e 0xa55 0xa52 0xa78 0xa60 0xad4 0xa96 0xa73 0xa63 0xa45 0xa29 0xa25 0xa08 0x9f3 0xa29 0xa3a 0xa4e 0xa49 0xa57 0xa61 0xa60 0xa84 0xa7a 0xae2 0xaa4 0xa7f 0xa6f 0xa50 0xa33 0xa32 0xa1b 0xa08 0xa95 0xaa6 0xab1 0xab4 0xac6 0xaca 0xac6 0xaef 0xaed 0xb2f 0xae6 0xabf 0xaae 0xa8e 0xa6f 0xa68 0xa4b 0xa39 0xa9b 0xaab 0xabc 0xabf 0xad0 0xad7 0xad4 0xaf8 0xb04 0xb68 0xb22 0xafe 0xaf3 0xad4 0xab2 0xab4 0xa94 0xa80 0xa96 0xaae 0xabb 0xabb 0xacc 0xacd 0xaca 0xaed 0xb08 0xb98 0xb4f 0xb29 0xb1b 0xaff 0xade 0xad7 0xac2 0xaaa 0xacc 0xae3 0xaf0 0xaf4 0xb08 0xb08 0xb04 0xb27 0xb47 0xbe4 0xb9b 0xb75 0xb6a 0xb4f 0xb2c 0xb24 0xb0d 0xaf3 0xb25 0xb36 0xb48 0xb48 0xb60 0xb64 0xb5c 0xb83 0xbb3 0xc0c 0xbc5 0xba3 0xb94 0xb76 0xb5d 0xb58 0xb41 0xb28 0xb21 0xb35 0xb45 0xb48 0xb56 0xb5c 0xb59 0xb7d 0xbb8 0xc4e 0xbfe 0xbdd 0xbcc 0xbb3 0xb92 0xb8d 0xb71 0xb5a 0xb83 0xb94 0xba7 0xbac 0xbbf 0xbc2 0xbb8 0xbd8 0xc1e 0xc62 0xc15 0xbf6 0xbe2 0xbc5 0xba5 0xb9e 0xb80 0xb67 0xb84 0xb98 0xbb1 0xbae 0xbbe 0xbc3 0xbbc 0xbdd 0xc23 0xc98 0xc4f 0xc32 0xc27 0xc07 0xbe4 0xbe4 0xbc2 0xba9 0xbaa 0xbc2 0xbd0 0xbdd 0xbec 0xbf2 0xbef 0xc0e 0xc56 0xcb1 0xc67 0xc46 0xc3c 0xc21 0xc09 0xc00 0xbe6 0xbcd 0xbf2 0xc07 0xc16 0xc23 0xc2f 0xc33 0xc31 0xc4e 0xc9e 0xd43 0xcf5 0xcd0 0xcc4 0xca6 0xc83 0xc7c 0xc60 0xc43 0xc0f 0xc2b 0xc43 0xc48 0xc58 0xc5c 0xc4f 0xc71 0xcc4 0xd59 0xd0f 0xcef 0xce1 0xcc6 0xca2 0xc97 0xc7f 0xc5f 0xc75 0xc93 0xca2 0xca9 0xcb8 0xcbe 0xcb6 0xcd2 0xd20 0xd91 0xd43 0xd23 0xd0f 0xcf6 0xcd9 0xccb 0xcb0 0xc89 0xc9e 0xcba 0xcd3 0xcda 0xcec 0xcf2 0xce8 0xd04 0xd54 0xdc2 0xd74 0xd58 0xd42 0xd26 0xd07 0xcfc 0xce0 0xcbf 0xcbb 0xcd6 0xce9 0xcf3 0xd04 0xd08 0xd01 0xd20 0xd6c 0xe58 0xe0a 0xdee 0xddc 0xdb6 0xd91 0xd86 0xd66 0xd44 0xd28 0xd46 0xd59 0xd5f 0xd6e 0xd6e 0xd65 0xd7c 0xdce 0xe24 0xddc 0xdc0 0xdad 0xd8c 0xd6a 0xd62 0xd43 0xd1d 0xd3f 0xd5f 0xd77 0xd82 0xd97 0xd9e 0xd9d 0xdb9 0xe04 0xe6d 0xe2b 0xe0b 0xdfa 0xddd 0xdba 0xdad 0xd91 0xd6e 0xd70 0xd94 0xda5 0xdb3 0xdc5 0xdc9 0xdc8 0xde4 0xe31 0xea4 0xe5f 0xe43 0xe32 0xe11 0xdec 0xde0 0xdbd 0xd9d 0xd97 0xdb6 0xdc9 0xdd3 0xddd 0xde5 0xddd 0xdf3 0xe40 0xe63 0xedf 0xec0 0xeb2 0xe8d 0xe5f 0xe4e 0xe2b 0xe03 0xde3 0xdff 0xe15 0xe1b 0xe32 0xe3c 0xe32 0xe4c 0xdf6 0xe6c 0xedf 0xecc 0xeb9 0xe9a 0xe78 0xe63 0xe43 0xe1b 0xdea 0xe0b 0xe22 0xe32 0xe47 0xe4d 0xe4d 0xe61 0xe1d 0xeb7 0xf49 0xf31 0xf1c 0xef9 0xed2 0xebe 0xe9b 0xe73 0xe29 0xe49 0xe5e 0xe6c 0xe84 0xe85 0xe86 0xe9b 0xe40 0xe9e 0xf4c 0xf5b 0xf49 0xf25 0xf04 0xef4 0xecf 0xea7 0xe38 0xe5e 0xe77 0xe84 0xe9d 0xea5 0xea4 0xe96 0xe26 0x1400 0x1400 0x1400>;
			PS_Config_Lmt_Open_Rawdata_N = <0x42a 0x421 0x413 0x407 0x3f8 0x3eb 0x3ec 0x3cc 0xffff0001 0xffff0001 0x3b9 0x3d3 0x3d3 0x3d7 0x3dc 0x3e0 0x3eb 0x40b 0x43d 0x43d 0x434 0x42e 0x423 0x416 0x410 0x404 0x3fa 0x3d7 0x3df 0x3e7 0x3ec 0x3f4 0x3f6 0x3f5 0x3fd 0x418 0x456 0x458 0x451 0x44c 0x442 0x436 0x42d 0x422 0x419 0x3e1 0x3e9 0x3f0 0x3f4 0x3fb 0x3fd 0x3fa 0x401 0x41c 0x44b 0x455 0x44c 0x445 0x43a 0x42d 0x425 0x41b 0x40f 0x3ef 0x3f8 0x3fe 0x405 0x40a 0x40d 0x40d 0x415 0x42e 0x466 0x475 0x46b 0x464 0x45a 0x44c 0x443 0x438 0x42c 0x401 0x409 0x411 0x416 0x41f 0x41f 0x41c 0x422 0x43c 0x481 0x494 0x48b 0x483 0x477 0x46b 0x463 0x457 0x44c 0x40f 0x416 0x41f 0x424 0x42c 0x42e 0x42b 0x434 0x44b 0x46c 0x456 0x442 0x43b 0x42d 0x41e 0x41c 0x411 0x40a 0x434 0x43c 0x444 0x444 0x44a 0x44e 0x44d 0x461 0x44c 0x476 0x45d 0x44e 0x447 0x43c 0x430 0x42e 0x424 0x41d 0x444 0x44b 0x451 0x454 0x45b 0x45e 0x45f 0x470 0x461 0x48e 0x473 0x464 0x45c 0x44f 0x442 0x43f 0x436 0x42d 0x455 0x45b 0x463 0x463 0x46a 0x46d 0x46c 0x47c 0x472 0x4a4 0x48a 0x47b 0x473 0x467 0x45b 0x459 0x44c 0x443 0x45b 0x462 0x46a 0x469 0x46f 0x473 0x472 0x482 0x47e 0x4aa 0x490 0x47f 0x479 0x46c 0x45f 0x45e 0x455 0x44c 0x489 0x490 0x495 0x496 0x49e 0x4a0 0x49e 0x4af 0x4af 0x4cb 0x4ac 0x49b 0x494 0x486 0x479 0x476 0x469 0x461 0x48b 0x493 0x49a 0x49b 0x4a2 0x4a5 0x4a4 0x4b4 0x4b8 0x4e4 0x4c6 0x4b6 0x4b1 0x4a4 0x496 0x496 0x488 0x480 0x48a 0x494 0x499 0x499 0x4a0 0x4a1 0x4a0 0x4af 0x4ba 0x4f8 0x4d9 0x4c9 0x4c3 0x4b7 0x4a8 0x4a5 0x49c 0x492 0x4a0 0x4ab 0x4b0 0x4b2 0x4ba 0x4ba 0x4b8 0x4c7 0x4d5 0x518 0x4f9 0x4e9 0x4e4 0x4d9 0x4ca 0x4c6 0x4bd 0x4b1 0x4c7 0x4ce 0x4d6 0x4d6 0x4e0 0x4e2 0x4de 0x4ef 0x503 0x52a 0x50b 0x4fd 0x4f6 0x4ea 0x4df 0x4dc 0x4d3 0x4c8 0x4c5 0x4cd 0x4d5 0x4d6 0x4dc 0x4de 0x4dd 0x4ed 0x506 0x546 0x524 0x515 0x50e 0x503 0x4f6 0x4f3 0x4e7 0x4de 0x4ef 0x4f6 0x4ff 0x500 0x509 0x50a 0x506 0x514 0x532 0x54e 0x52d 0x520 0x518 0x50b 0x4fd 0x4fa 0x4ee 0x4e3 0x4f0 0x4f8 0x503 0x502 0x508 0x50b 0x508 0x515 0x533 0x566 0x547 0x53a 0x535 0x527 0x518 0x518 0x50a 0x4ff 0x500 0x50a 0x510 0x515 0x51c 0x51e 0x51d 0x52a 0x54a 0x571 0x551 0x542 0x53e 0x533 0x529 0x524 0x51a 0x50f 0x51e 0x527 0x52e 0x533 0x539 0x53b 0x539 0x546 0x568 0x5af 0x58d 0x57e 0x578 0x56c 0x55d 0x55a 0x54e 0x541 0x52b 0x537 0x541 0x544 0x54a 0x54c 0x547 0x555 0x578 0x5b9 0x599 0x58b 0x585 0x57a 0x56a 0x565 0x55b 0x54d 0x557 0x563 0x56a 0x56d 0x574 0x576 0x572 0x57e 0x5a0 0x5d1 0x5af 0x5a1 0x599 0x58e 0x581 0x57b 0x570 0x55f 0x568 0x574 0x57f 0x582 0x58a 0x58c 0x588 0x594 0x5b6 0x5e6 0x5c4 0x5b8 0x5ae 0x5a2 0x595 0x590 0x584 0x577 0x575 0x580 0x589 0x58d 0x594 0x596 0x593 0x5a0 0x5c0 0x626 0x604 0x5f8 0x5f0 0x5e0 0x5d1 0x5cc 0x5be 0x5b0 0x5a4 0x5b0 0x5b9 0x5bb 0x5c2 0x5c2 0x5bd 0x5c8 0x5ea 0x610 0x5f0 0x5e4 0x5dd 0x5ce 0x5c0 0x5bc 0x5af 0x59f 0x5ad 0x5bb 0x5c5 0x5ca 0x5d3 0x5d6 0x5d5 0x5e1 0x602 0x62f 0x613 0x605 0x5fe 0x5f1 0x5e2 0x5dd 0x5d1 0x5c2 0x5c2 0x5d2 0x5d9 0x5df 0x5e7 0x5e9 0x5e8 0x5f4 0x615 0x646 0x629 0x61d 0x616 0x607 0x5f8 0x5f2 0x5e3 0x5d5 0x5d3 0x5e0 0x5e9 0x5ed 0x5f1 0x5f5 0x5f1 0x5fb 0x61c 0x62b 0x65f 0x652 0x64c 0x63d 0x629 0x622 0x613 0x601 0x5f3 0x5ff 0x609 0x60b 0x616 0x61a 0x616 0x620 0x5fc 0x62e 0x65f 0x658 0x64f 0x642 0x634 0x62b 0x61d 0x60b 0x5f6 0x605 0x60e 0x616 0x61f 0x621 0x621 0x629 0x60d 0x64f 0x68d 0x683 0x67a 0x66b 0x65a 0x652 0x643 0x631 0x611 0x61f 0x628 0x62e 0x638 0x639 0x63a 0x643 0x61c 0x644 0x68e 0x695 0x68d 0x67d 0x670 0x668 0x659 0x647 0x618 0x628 0x633 0x638 0x643 0x647 0x646 0x640 0x610 0xfffffe01 0xfffffe01 0xfffffe01>;
			PS_Config_Lmt_FW_Rawdata_P = <0x45d 0x46b 0x459 0x459 0x459 0x45f 0x45c 0x44e 0xffff 0xffff 0x461 0x448 0x456 0x47b 0x478 0x448 0x46e 0x447 0x45f 0x472 0x47b 0x43a 0x45a 0x468 0x46a 0x46e 0x44e 0x464 0x460 0x46b 0x46e 0x474 0x45d 0x466 0x456 0x476 0x468 0x459 0x46b 0x455 0x456 0x453 0x455 0x453 0x466 0x472 0x466 0x468 0x46e 0x471 0x461 0x459 0x466 0x456 0x456 0x468 0x46f 0x44a 0x45c 0x461 0x463 0x464 0x45f 0x46b 0x459 0x456 0x461 0x464 0x461 0x455 0x459 0x463 0x48e 0x460 0x430 0x471 0x467 0x46a 0x45a 0x45c 0x48a 0x455 0x478 0x46b 0x464 0x464 0x458 0x478 0x460 0x46d 0x47c 0x44f 0x46b 0x44b 0x443 0x443 0x436 0x437 0x47c 0x44b 0x479 0x478 0x47c 0x47d 0x479 0x456 0x46a 0x459 0x464 0x456 0x458 0x468 0x463 0x461 0x46b 0x45f 0x479 0x445 0x44e 0x460 0x463 0x464 0x456 0x466 0x474 0x46e 0x44a 0x453 0x458 0x46b 0x467 0x46d 0x456 0x452 0x45f 0x44f 0x44e 0x45a 0x468 0x459 0x44e 0x460 0x484 0x43e 0x464 0x461 0x448 0x458 0x45f 0x46a 0x452 0x44e 0x451 0x45c 0x46f 0x46a 0x468 0x464 0x464 0x44b 0x458 0x459 0x45c 0x479 0x459 0x44f 0x44b 0x44f 0x456 0x45a 0x45f 0x46d 0x459 0x447 0x443 0x441 0x441 0x44f 0x476 0x43c 0x461 0x456 0x45c 0x478 0x47d 0x482 0x45d 0x441 0x448 0x46e 0x46f 0x46e 0x45d 0x45f 0x45a 0x466 0x45d 0x45f 0x487 0x461 0x46d 0x459 0x459 0x460 0x476 0x478 0x464 0x463 0x452 0x45f 0x47b 0x484 0x482 0x459 0x463 0x453 0x466 0x46f 0x451 0x44e 0x44e 0x44e 0x46a 0x474 0x479 0x459 0x464 0x452 0x45c 0x46a 0x467 0x463 0x466 0x461 0x456 0x445 0x48b 0x480 0x48b 0x48e 0x47d 0x44e 0x439 0x461 0x480 0x479 0x463 0x464 0x45a 0x46d 0x44e 0x475 0x46b 0x476 0x44f 0x464 0x460 0x463 0x464 0x46a 0x461 0x461 0x45f 0x46b 0x472 0x479 0x472 0x46b 0x460 0x461 0x459 0x44b 0x464 0x467 0x464 0x464 0x461 0x451 0x455 0x44e 0x486 0x478 0x472 0x46e 0x467 0x463 0x45c 0x467 0x460 0x45f 0x461 0x466 0x463 0x463 0x466 0x468 0x459 0x447 0x474 0x479 0x478 0x47f 0x484 0x476 0x444 0x436 0x463 0x468 0x460 0x475 0x46f 0x46d 0x46e 0x471 0x460 0x467 0x46a 0x468 0x46b 0x45d 0x46b 0x46d 0x45d 0x43c 0x471 0x46b 0x459 0x452 0x458 0x459 0x44a 0x458 0x458 0x463 0x45c 0x451 0x455 0x464 0x45d 0x460 0x455 0x472 0x456 0x44b 0x46a 0x475 0x46d 0x479 0x478 0x45c 0x444 0x444 0x46a 0x478 0x476 0x474 0x475 0x45c 0x463 0x46a 0x45a 0x458 0x476 0x46a 0x463 0x464 0x46a 0x458 0x455 0x44b 0x461 0x46b 0x475 0x46f 0x46f 0x472 0x463 0x456 0x46f 0x464 0x460 0x45d 0x45d 0x45d 0x458 0x456 0x447 0x459 0x476 0x475 0x476 0x475 0x46f 0x467 0x466 0x46e 0x44a 0x447 0x46b 0x46d 0x474 0x471 0x479 0x474 0x45d 0x458 0x467 0x464 0x474 0x474 0x46e 0x474 0x44b 0x455 0x45f 0x45a 0x45a 0x461 0x460 0x460 0x45d 0x464 0x459 0x463 0x460 0x45a 0x455 0x456 0x455 0x456 0x46b 0x480 0x47c 0x479 0x447 0x458 0x45d 0x45c 0x461 0x45d 0x476 0x47c 0x46a 0x467 0x45d 0x45c 0x45f 0x466 0x46e 0x45c 0x45c 0x45c 0x45c 0x456 0x45c 0x452 0x455 0x456 0x460 0x45d 0x45a 0x45a 0x45a 0x45a 0x460 0x45d 0x46d 0x461 0x468 0x47f 0x459 0x44f 0x448 0x44f 0x447 0x44e 0x46a 0x467 0x478 0x472 0x47b 0x476 0x47b 0x471 0x464 0x45f 0x46b 0x46b 0x44e 0x44a 0x443 0x447 0x44a 0x44e 0x461 0x44b 0x453 0x466 0x467 0x464 0x45c 0x471 0x460 0x458 0x463 0x464 0x479 0x472 0x47b 0x475 0x479 0x46b 0x441 0x464 0x45c 0x45d 0x458 0x459 0x460 0x451 0x46e 0x463 0x479 0x468 0x44b 0x452 0x451 0x452 0x456 0x45a 0x46d 0x45d 0x44c 0x451 0x448 0x451 0x444 0x46b 0x45a 0x459 0x46e 0x45a 0x466 0x45d 0x45f 0x45f 0x466 0x46a 0x45d 0x46a 0x45c 0x463 0x45f 0x45f 0x467 0x45a 0x486 0x479 0x46f 0x479 0x466 0x46a 0x46b 0x46d 0x46a 0x46d 0x461 0x45f 0x44c 0x44b 0x44e 0x44e 0x44c 0x455 0x45c 0x458 0xf00 0xf00 0xf00>;
			PS_Config_Lmt_FW_Rawdata_N = <0x1df 0x1e5 0x1dd 0x1dd 0x1dd 0x1df 0x1de 0x1d8 0xffff0001 0xffff0001 0x1e1 0x1d6 0x1dc 0x1eb 0x1ea 0x1d6 0x1e6 0x1d5 0x1df 0x1e8 0x1eb 0x1d0 0x1de 0x1e4 0x1e4 0x1e6 0x1d8 0x1e2 0x1e0 0x1e5 0x1e6 0x1e8 0x1df 0x1e2 0x1dc 0x1ea 0x1e4 0x1dd 0x1e5 0x1db 0x1dc 0x1db 0x1db 0x1db 0x1e2 0x1e8 0x1e2 0x1e4 0x1e6 0x1e7 0x1e1 0x1dd 0x1e2 0x1dc 0x1dc 0x1e4 0x1e7 0x1d6 0x1de 0x1e1 0x1e1 0x1e2 0x1df 0x1e5 0x1dd 0x1dc 0x1e1 0x1e2 0x1e1 0x1db 0x1dd 0x1e1 0x1f4 0x1e0 0x1cc 0x1e7 0x1e3 0x1e4 0x1de 0x1de 0x1f2 0x1db 0x1ea 0x1e5 0x1e2 0x1e2 0x1dc 0x1ea 0x1e0 0x1e5 0x1ec 0x1d9 0x1e5 0x1d7 0x1d3 0x1d3 0x1ce 0x1cf 0x1ec 0x1d7 0x1eb 0x1ea 0x1ec 0x1ed 0x1eb 0x1dc 0x1e4 0x1dd 0x1e2 0x1dc 0x1dc 0x1e4 0x1e1 0x1e1 0x1e5 0x1df 0x1eb 0x1d5 0x1d8 0x1e0 0x1e1 0x1e2 0x1dc 0x1e2 0x1e8 0x1e6 0x1d6 0x1db 0x1dc 0x1e5 0x1e3 0x1e5 0x1dc 0x1da 0x1df 0x1d9 0x1d8 0x1de 0x1e4 0x1dd 0x1d8 0x1e0 0x1f0 0x1d2 0x1e2 0x1e1 0x1d6 0x1dc 0x1df 0x1e4 0x1da 0x1d8 0x1d9 0x1de 0x1e7 0x1e4 0x1e4 0x1e2 0x1e2 0x1d7 0x1dc 0x1dd 0x1de 0x1eb 0x1dd 0x1d9 0x1d7 0x1d9 0x1dc 0x1de 0x1df 0x1e5 0x1dd 0x1d5 0x1d3 0x1d3 0x1d3 0x1d9 0x1ea 0x1d0 0x1e1 0x1dc 0x1de 0x1ea 0x1ed 0x1ee 0x1df 0x1d3 0x1d6 0x1e6 0x1e7 0x1e6 0x1df 0x1df 0x1de 0x1e2 0x1df 0x1df 0x1f1 0x1e1 0x1e5 0x1dd 0x1dd 0x1e0 0x1ea 0x1ea 0x1e2 0x1e1 0x1da 0x1df 0x1eb 0x1f0 0x1ee 0x1dd 0x1e1 0x1db 0x1e2 0x1e7 0x1d9 0x1d8 0x1d8 0x1d8 0x1e4 0x1e8 0x1eb 0x1dd 0x1e2 0x1da 0x1de 0x1e4 0x1e3 0x1e1 0x1e2 0x1e1 0x1dc 0x1d5 0x1f3 0x1ee 0x1f3 0x1f4 0x1ed 0x1d8 0x1cf 0x1e1 0x1ee 0x1eb 0x1e1 0x1e2 0x1de 0x1e5 0x1d8 0x1e9 0x1e5 0x1ea 0x1d9 0x1e2 0x1e0 0x1e1 0x1e2 0x1e4 0x1e1 0x1e1 0x1df 0x1e5 0x1e8 0x1eb 0x1e8 0x1e5 0x1e0 0x1e1 0x1dd 0x1d7 0x1e2 0x1e3 0x1e2 0x1e2 0x1e1 0x1d9 0x1db 0x1d8 0x1f0 0x1ea 0x1e8 0x1e6 0x1e3 0x1e1 0x1de 0x1e3 0x1e0 0x1df 0x1e1 0x1e2 0x1e1 0x1e1 0x1e2 0x1e4 0x1dd 0x1d5 0x1e8 0x1eb 0x1ea 0x1ed 0x1f0 0x1ea 0x1d4 0x1ce 0x1e1 0x1e4 0x1e0 0x1e9 0x1e7 0x1e5 0x1e6 0x1e7 0x1e0 0x1e3 0x1e4 0x1e4 0x1e5 0x1df 0x1e5 0x1e5 0x1df 0x1d0 0x1e7 0x1e5 0x1dd 0x1da 0x1dc 0x1dd 0x1d6 0x1dc 0x1dc 0x1e1 0x1de 0x1d9 0x1db 0x1e2 0x1df 0x1e0 0x1db 0x1e8 0x1dc 0x1d7 0x1e4 0x1e9 0x1e5 0x1eb 0x1ea 0x1de 0x1d4 0x1d4 0x1e4 0x1ea 0x1ea 0x1e8 0x1e9 0x1de 0x1e1 0x1e4 0x1de 0x1dc 0x1ea 0x1e4 0x1e1 0x1e2 0x1e4 0x1dc 0x1db 0x1d7 0x1e1 0x1e5 0x1e9 0x1e7 0x1e7 0x1e8 0x1e1 0x1dc 0x1e7 0x1e2 0x1e0 0x1df 0x1df 0x1df 0x1dc 0x1dc 0x1d5 0x1dd 0x1ea 0x1e9 0x1ea 0x1e9 0x1e7 0x1e3 0x1e2 0x1e6 0x1d6 0x1d5 0x1e5 0x1e5 0x1e8 0x1e7 0x1eb 0x1e8 0x1df 0x1dc 0x1e3 0x1e2 0x1e8 0x1e8 0x1e6 0x1e8 0x1d7 0x1db 0x1df 0x1de 0x1de 0x1e1 0x1e0 0x1e0 0x1df 0x1e2 0x1dd 0x1e1 0x1e0 0x1de 0x1db 0x1dc 0x1db 0x1dc 0x1e5 0x1ee 0x1ec 0x1eb 0x1d5 0x1dc 0x1df 0x1de 0x1e1 0x1df 0x1ea 0x1ec 0x1e4 0x1e3 0x1df 0x1de 0x1df 0x1e2 0x1e6 0x1de 0x1de 0x1de 0x1de 0x1dc 0x1de 0x1da 0x1db 0x1dc 0x1e0 0x1df 0x1de 0x1de 0x1de 0x1de 0x1e0 0x1df 0x1e5 0x1e1 0x1e4 0x1ed 0x1dd 0x1d9 0x1d6 0x1d9 0x1d5 0x1d8 0x1e4 0x1e3 0x1ea 0x1e8 0x1eb 0x1ea 0x1eb 0x1e7 0x1e2 0x1df 0x1e5 0x1e5 0x1d8 0x1d6 0x1d3 0x1d5 0x1d6 0x1d8 0x1e1 0x1d7 0x1db 0x1e2 0x1e3 0x1e2 0x1de 0x1e7 0x1e0 0x1dc 0x1e1 0x1e2 0x1eb 0x1e8 0x1eb 0x1e9 0x1eb 0x1e5 0x1d3 0x1e2 0x1de 0x1df 0x1dc 0x1dd 0x1e0 0x1d9 0x1e6 0x1e1 0x1eb 0x1e4 0x1d7 0x1da 0x1d9 0x1da 0x1dc 0x1de 0x1e5 0x1df 0x1d8 0x1d9 0x1d6 0x1d9 0x1d4 0x1e5 0x1de 0x1dd 0x1e6 0x1de 0x1e2 0x1df 0x1df 0x1df 0x1e2 0x1e4 0x1df 0x1e4 0x1de 0x1e1 0x1df 0x1df 0x1e3 0x1de 0x1f0 0x1eb 0x1e7 0x1eb 0x1e2 0x1e4 0x1e5 0x1e5 0x1e4 0x1e5 0x1e1 0x1df 0x1d8 0x1d7 0x1d8 0x1d8 0x1d8 0x1db 0x1de 0x1dc 0xf0 0xf0 0xf0>;
			PS_Config_Lmt_FW_CC_P = <0x2f 0x2e 0x2c 0x2b 0x2b 0x2b 0x2b 0x2b 0xffff 0xffff 0x2b 0x2b 0x2b 0x29 0x2b 0x2b 0x2c 0x2f 0x32 0x2f 0x2e 0x2e 0x2e 0x2e 0x2e 0x2e 0x2e 0x2e 0x2e 0x2c 0x2e 0x2c 0x2e 0x2e 0x2f 0x32 0x32 0x30 0x2f 0x2e 0x2e 0x2e 0x2e 0x2e 0x2e 0x2e 0x2e 0x2e 0x2e 0x2e 0x2e 0x2e 0x30 0x32 0x32 0x30 0x2e 0x2e 0x2e 0x2e 0x2e 0x2e 0x2e 0x2e 0x2e 0x2e 0x2e 0x2e 0x2e 0x2e 0x30 0x32 0x33 0x30 0x2f 0x2e 0x2e 0x2e 0x2e 0x2e 0x2f 0x2f 0x2e 0x2e 0x2e 0x2e 0x2e 0x2f 0x30 0x33 0x33 0x30 0x2f 0x2f 0x2f 0x2f 0x2f 0x2e 0x2f 0x2e 0x2e 0x2e 0x2e 0x2e 0x2e 0x2f 0x30 0x33 0x33 0x30 0x2f 0x2e 0x2e 0x2e 0x2e 0x2e 0x2e 0x2e 0x2e 0x2e 0x2e 0x2e 0x2e 0x30 0x32 0x33 0x33 0x30 0x2f 0x2e 0x2e 0x2e 0x2e 0x2e 0x2e 0x2f 0x2e 0x2e 0x2e 0x2e 0x2e 0x30 0x32 0x33 0x33 0x30 0x2f 0x2e 0x2e 0x2e 0x2e 0x2e 0x2e 0x2f 0x2e 0x2e 0x2e 0x2e 0x2e 0x2f 0x32 0x33 0x33 0x30 0x2f 0x2e 0x2e 0x2e 0x2e 0x2e 0x2e 0x2f 0x2e 0x2e 0x2e 0x2e 0x2e 0x30 0x32 0x33 0x34 0x32 0x2f 0x2e 0x2e 0x2e 0x2e 0x2e 0x2f 0x2f 0x2f 0x2f 0x2f 0x2f 0x2f 0x30 0x32 0x34 0x33 0x30 0x2f 0x2e 0x2e 0x2e 0x2e 0x2e 0x2e 0x2e 0x2e 0x2e 0x2e 0x2e 0x2e 0x2f 0x32 0x33 0x34 0x32 0x2f 0x2e 0x2e 0x2e 0x2e 0x2e 0x2f 0x2f 0x2f 0x2f 0x2f 0x2e 0x2e 0x30 0x32 0x34 0x33 0x32 0x2f 0x2e 0x2e 0x2e 0x2e 0x2e 0x2f 0x2f 0x2e 0x2e 0x2e 0x2e 0x2e 0x2f 0x32 0x33 0x34 0x32 0x30 0x2f 0x2f 0x2f 0x2f 0x2f 0x2f 0x2f 0x2f 0x2f 0x2e 0x2e 0x2e 0x2f 0x32 0x34 0x34 0x32 0x2f 0x2e 0x2e 0x2e 0x2e 0x2f 0x2f 0x2f 0x2f 0x2e 0x2e 0x2e 0x2e 0x2f 0x32 0x34 0x34 0x32 0x30 0x2f 0x2f 0x2f 0x2f 0x2f 0x2f 0x2f 0x2f 0x2f 0x2f 0x2f 0x2f 0x30 0x32 0x34 0x34 0x32 0x30 0x2f 0x2f 0x2f 0x2f 0x2f 0x2f 0x2f 0x2f 0x2f 0x2f 0x2f 0x2f 0x30 0x32 0x34 0x34 0x32 0x30 0x2f 0x2f 0x2f 0x2f 0x2f 0x2f 0x30 0x2f 0x2f 0x2f 0x2f 0x2f 0x30 0x32 0x34 0x36 0x33 0x30 0x2f 0x2f 0x2f 0x2f 0x2f 0x30 0x30 0x2f 0x2f 0x2f 0x2f 0x2f 0x30 0x32 0x34 0x36 0x33 0x30 0x2f 0x2f 0x2f 0x2f 0x30 0x30 0x30 0x2f 0x2f 0x2f 0x2f 0x2f 0x30 0x33 0x36 0x36 0x33 0x30 0x2f 0x2f 0x2f 0x2f 0x2f 0x30 0x30 0x2f 0x2f 0x2f 0x2f 0x2f 0x30 0x33 0x36 0x36 0x33 0x32 0x30 0x30 0x30 0x30 0x30 0x30 0x30 0x30 0x30 0x30 0x30 0x30 0x30 0x33 0x36 0x36 0x33 0x30 0x2f 0x30 0x30 0x30 0x30 0x30 0x30 0x30 0x30 0x30 0x30 0x30 0x32 0x33 0x36 0x37 0x34 0x32 0x30 0x30 0x30 0x30 0x30 0x32 0x30 0x30 0x30 0x30 0x30 0x30 0x32 0x33 0x36 0x36 0x33 0x30 0x30 0x30 0x30 0x30 0x30 0x30 0x30 0x30 0x30 0x30 0x30 0x30 0x32 0x33 0x36 0x36 0x33 0x32 0x30 0x30 0x30 0x30 0x30 0x30 0x32 0x30 0x30 0x30 0x30 0x30 0x32 0x34 0x37 0x36 0x33 0x32 0x30 0x30 0x30 0x30 0x30 0x30 0x32 0x30 0x30 0x30 0x30 0x30 0x32 0x33 0x36 0x34 0x34 0x32 0x30 0x30 0x30 0x30 0x30 0x32 0x30 0x30 0x30 0x30 0x30 0x30 0x32 0x33 0x34 0x34 0x33 0x32 0x30 0x30 0x30 0x30 0x30 0x30 0x30 0x30 0x30 0x30 0x30 0x30 0x32 0x33 0x34 0x34 0x33 0x32 0x30 0x30 0x30 0x30 0x30 0x30 0x30 0x30 0x30 0x30 0x30 0x30 0x32 0x33 0x34 0x34 0x33 0x32 0x30 0x30 0x30 0x30 0x30 0x30 0x30 0x30 0x30 0x30 0x30 0x30 0x32 0x33 0x34 0x13a 0x13a 0x13a>;
			PS_Config_Lmt_FW_CC_N = <0x15 0x14 0x14 0x13 0x13 0x13 0x13 0x13 0xffff0001 0xffff0001 0x13 0x13 0x13 0x13 0x13 0x13 0x14 0x15 0x16 0x15 0x14 0x14 0x14 0x14 0x14 0x14 0x14 0x14 0x14 0x14 0x14 0x14 0x14 0x14 0x15 0x16 0x16 0x16 0x15 0x14 0x14 0x14 0x14 0x14 0x14 0x14 0x14 0x14 0x14 0x14 0x14 0x14 0x16 0x16 0x16 0x16 0x14 0x14 0x14 0x14 0x14 0x14 0x14 0x14 0x14 0x14 0x14 0x14 0x14 0x14 0x16 0x16 0x17 0x16 0x15 0x14 0x14 0x14 0x14 0x14 0x15 0x15 0x14 0x14 0x14 0x14 0x14 0x15 0x16 0x17 0x17 0x16 0x15 0x15 0x15 0x15 0x15 0x14 0x15 0x14 0x14 0x14 0x14 0x14 0x14 0x15 0x16 0x17 0x17 0x16 0x15 0x14 0x14 0x14 0x14 0x14 0x14 0x14 0x14 0x14 0x14 0x14 0x14 0x16 0x16 0x17 0x17 0x16 0x15 0x14 0x14 0x14 0x14 0x14 0x14 0x15 0x14 0x14 0x14 0x14 0x14 0x16 0x16 0x17 0x17 0x16 0x15 0x14 0x14 0x14 0x14 0x14 0x14 0x15 0x14 0x14 0x14 0x14 0x14 0x15 0x16 0x17 0x17 0x16 0x15 0x14 0x14 0x14 0x14 0x14 0x14 0x15 0x14 0x14 0x14 0x14 0x14 0x16 0x16 0x17 0x18 0x16 0x15 0x14 0x14 0x14 0x14 0x14 0x15 0x15 0x15 0x15 0x15 0x15 0x15 0x16 0x16 0x18 0x17 0x16 0x15 0x14 0x14 0x14 0x14 0x14 0x14 0x14 0x14 0x14 0x14 0x14 0x14 0x15 0x16 0x17 0x18 0x16 0x15 0x14 0x14 0x14 0x14 0x14 0x15 0x15 0x15 0x15 0x15 0x14 0x14 0x16 0x16 0x18 0x17 0x16 0x15 0x14 0x14 0x14 0x14 0x14 0x15 0x15 0x14 0x14 0x14 0x14 0x14 0x15 0x16 0x17 0x18 0x16 0x16 0x15 0x15 0x15 0x15 0x15 0x15 0x15 0x15 0x15 0x14 0x14 0x14 0x15 0x16 0x18 0x18 0x16 0x15 0x14 0x14 0x14 0x14 0x15 0x15 0x15 0x15 0x14 0x14 0x14 0x14 0x15 0x16 0x18 0x18 0x16 0x16 0x15 0x15 0x15 0x15 0x15 0x15 0x15 0x15 0x15 0x15 0x15 0x15 0x16 0x16 0x18 0x18 0x16 0x16 0x15 0x15 0x15 0x15 0x15 0x15 0x15 0x15 0x15 0x15 0x15 0x15 0x16 0x16 0x18 0x18 0x16 0x16 0x15 0x15 0x15 0x15 0x15 0x15 0x16 0x15 0x15 0x15 0x15 0x15 0x16 0x16 0x18 0x18 0x17 0x16 0x15 0x15 0x15 0x15 0x15 0x16 0x16 0x15 0x15 0x15 0x15 0x15 0x16 0x16 0x18 0x18 0x17 0x16 0x15 0x15 0x15 0x15 0x16 0x16 0x16 0x15 0x15 0x15 0x15 0x15 0x16 0x17 0x18 0x18 0x17 0x16 0x15 0x15 0x15 0x15 0x15 0x16 0x16 0x15 0x15 0x15 0x15 0x15 0x16 0x17 0x18 0x18 0x17 0x16 0x16 0x16 0x16 0x16 0x16 0x16 0x16 0x16 0x16 0x16 0x16 0x16 0x16 0x17 0x18 0x18 0x17 0x16 0x15 0x16 0x16 0x16 0x16 0x16 0x16 0x16 0x16 0x16 0x16 0x16 0x16 0x17 0x18 0x19 0x18 0x16 0x16 0x16 0x16 0x16 0x16 0x16 0x16 0x16 0x16 0x16 0x16 0x16 0x16 0x17 0x18 0x18 0x17 0x16 0x16 0x16 0x16 0x16 0x16 0x16 0x16 0x16 0x16 0x16 0x16 0x16 0x16 0x17 0x18 0x18 0x17 0x16 0x16 0x16 0x16 0x16 0x16 0x16 0x16 0x16 0x16 0x16 0x16 0x16 0x16 0x18 0x19 0x18 0x17 0x16 0x16 0x16 0x16 0x16 0x16 0x16 0x16 0x16 0x16 0x16 0x16 0x16 0x16 0x17 0x18 0x18 0x18 0x16 0x16 0x16 0x16 0x16 0x16 0x16 0x16 0x16 0x16 0x16 0x16 0x16 0x16 0x17 0x18 0x18 0x17 0x16 0x16 0x16 0x16 0x16 0x16 0x16 0x16 0x16 0x16 0x16 0x16 0x16 0x16 0x17 0x18 0x18 0x17 0x16 0x16 0x16 0x16 0x16 0x16 0x16 0x16 0x16 0x16 0x16 0x16 0x16 0x16 0x17 0x18 0x18 0x17 0x16 0x16 0x16 0x16 0x16 0x16 0x16 0x16 0x16 0x16 0x16 0x16 0x16 0x16 0x17 0x18 0x00 0x00 0x00>;
			PS_Config_Lmt_FW_Diff_P = <0x32 0x32 0x32 0x32 0x32 0x32 0x32 0x32 0xffff 0xffff 0x32 0x32 0x32 0x32 0x32 0x32 0x32 0x32 0x32 0x32 0x32 0x32 0x32 0x32 0x32 0x32 0x32 0x32 0x32 0x32 0x32 0x32 0x32 0x32 0x32 0x32 0x32 0x32 0x32 0x32 0x32 0x32 0x32 0x32 0x32 0x32 0x32 0x32 0x32 0x32 0x32 0x32 0x32 0x32 0x32 0x32 0x32 0x32 0x32 0x32 0x32 0x32 0x32 0x32 0x32 0x32 0x32 0x32 0x32 0x32 0x32 0x32 0x32 0x32 0x32 0x32 0x32 0x32 0x32 0x32 0x32 0x32 0x32 0x32 0x32 0x32 0x32 0x32 0x32 0x32 0x32 0x32 0x32 0x32 0x32 0x32 0x32 0x32 0x32 0x32 0x32 0x32 0x32 0x32 0x32 0x32 0x32 0x32 0x32 0x32 0x32 0x32 0x32 0x32 0x32 0x32 0x32 0x32 0x32 0x32 0x32 0x32 0x32 0x32 0x32 0x32 0x32 0x32 0x32 0x32 0x32 0x32 0x32 0x32 0x32 0x32 0x32 0x32 0x32 0x32 0x32 0x32 0x32 0x32 0x32 0x32 0x32 0x32 0x32 0x32 0x32 0x32 0x32 0x32 0x32 0x32 0x32 0x32 0x32 0x32 0x32 0x32 0x32 0x32 0x32 0x32 0x32 0x32 0x32 0x32 0x32 0x32 0x32 0x32 0x32 0x32 0x32 0x32 0x32 0x32 0x32 0x32 0x32 0x32 0x32 0x32 0x32 0x32 0x32 0x32 0x32 0x32 0x32 0x32 0x32 0x32 0x32 0x32 0x32 0x32 0x32 0x32 0x32 0x32 0x32 0x32 0x32 0x32 0x32 0x32 0x32 0x32 0x32 0x32 0x32 0x32 0x32 0x32 0x32 0x32 0x32 0x32 0x32 0x32 0x32 0x32 0x32 0x32 0x32 0x32 0x32 0x32 0x32 0x32 0x32 0x32 0x32 0x32 0x32 0x32 0x32 0x32 0x32 0x32 0x32 0x32 0x32 0x32 0x32 0x32 0x32 0x32 0x32 0x32 0x32 0x32 0x32 0x32 0x32 0x32 0x32 0x32 0x32 0x32 0x32 0x32 0x32 0x32 0x32 0x32 0x32 0x32 0x32 0x32 0x32 0x32 0x32 0x32 0x32 0x32 0x32 0x32 0x32 0x32 0x32 0x32 0x32 0x32 0x32 0x32 0x32 0x32 0x32 0x32 0x32 0x32 0x32 0x32 0x32 0x32 0x32 0x32 0x32 0x32 0x32 0x32 0x32 0x32 0x32 0x32 0x32 0x32 0x32 0x32 0x32 0x32 0x32 0x32 0x32 0x32 0x32 0x32 0x32 0x32 0x32 0x32 0x32 0x32 0x32 0x32 0x32 0x32 0x32 0x32 0x32 0x32 0x32 0x32 0x32 0x32 0x32 0x32 0x32 0x32 0x32 0x32 0x32 0x32 0x32 0x32 0x32 0x32 0x32 0x32 0x32 0x32 0x32 0x32 0x32 0x32 0x32 0x32 0x32 0x32 0x32 0x32 0x32 0x32 0x32 0x32 0x32 0x32 0x32 0x32 0x32 0x32 0x32 0x32 0x32 0x32 0x32 0x32 0x32 0x32 0x32 0x32 0x32 0x32 0x32 0x32 0x32 0x32 0x32 0x32 0x32 0x32 0x32 0x32 0x32 0x32 0x32 0x32 0x32 0x32 0x32 0x32 0x32 0x32 0x32 0x32 0x32 0x32 0x32 0x32 0x32 0x32 0x32 0x32 0x32 0x32 0x32 0x32 0x32 0x32 0x32 0x32 0x32 0x32 0x32 0x32 0x32 0x32 0x32 0x32 0x32 0x32 0x32 0x32 0x32 0x32 0x32 0x32 0x32 0x32 0x32 0x32 0x32 0x32 0x32 0x32 0x32 0x32 0x32 0x32 0x32 0x32 0x32 0x32 0x32 0x32 0x32 0x32 0x32 0x32 0x32 0x32 0x32 0x32 0x32 0x32 0x32 0x32 0x32 0x32 0x32 0x32 0x32 0x32 0x32 0x32 0x32 0x32 0x32 0x32 0x32 0x32 0x32 0x32 0x32 0x32 0x32 0x32 0x32 0x32 0x32 0x32 0x32 0x32 0x32 0x32 0x32 0x32 0x32 0x32 0x32 0x32 0x32 0x32 0x32 0x32 0x32 0x32 0x32 0x32 0x32 0x32 0x32 0x32 0x32 0x32 0x32 0x32 0x32 0x32 0x32 0x32 0x32 0x32 0x32 0x32 0x32 0x32 0x32 0x32 0x32 0x32 0x32 0x32 0x32 0x32 0x32 0x32 0x32 0x32 0x32 0x32 0x32 0x32 0x32 0x32 0x32 0x32 0x32 0x32 0x32 0x32 0x32 0x32 0x32 0x32 0x32 0x32 0x32 0x32 0x32 0x32 0x32 0x32 0x32 0x32 0x32 0x32 0x32 0x32 0x32 0x32 0x4b 0x4b 0x4b>;
			PS_Config_Lmt_FW_Diff_N = <0xffffffce 0xffffffce 0xffffffce 0xffffffce 0xffffffce 0xffffffce 0xffffffce 0xffffffce 0xffff0001 0xffff0001 0xffffffce 0xffffffce 0xffffffce 0xffffffce 0xffffffce 0xffffffce 0xffffffce 0xffffffce 0xffffffce 0xffffffce 0xffffffce 0xffffffce 0xffffffce 0xffffffce 0xffffffce 0xffffffce 0xffffffce 0xffffffce 0xffffffce 0xffffffce 0xffffffce 0xffffffce 0xffffffce 0xffffffce 0xffffffce 0xffffffce 0xffffffce 0xffffffce 0xffffffce 0xffffffce 0xffffffce 0xffffffce 0xffffffce 0xffffffce 0xffffffce 0xffffffce 0xffffffce 0xffffffce 0xffffffce 0xffffffce 0xffffffce 0xffffffce 0xffffffce 0xffffffce 0xffffffce 0xffffffce 0xffffffce 0xffffffce 0xffffffce 0xffffffce 0xffffffce 0xffffffce 0xffffffce 0xffffffce 0xffffffce 0xffffffce 0xffffffce 0xffffffce 0xffffffce 0xffffffce 0xffffffce 0xffffffce 0xffffffce 0xffffffce 0xffffffce 0xffffffce 0xffffffce 0xffffffce 0xffffffce 0xffffffce 0xffffffce 0xffffffce 0xffffffce 0xffffffce 0xffffffce 0xffffffce 0xffffffce 0xffffffce 0xffffffce 0xffffffce 0xffffffce 0xffffffce 0xffffffce 0xffffffce 0xffffffce 0xffffffce 0xffffffce 0xffffffce 0xffffffce 0xffffffce 0xffffffce 0xffffffce 0xffffffce 0xffffffce 0xffffffce 0xffffffce 0xffffffce 0xffffffce 0xffffffce 0xffffffce 0xffffffce 0xffffffce 0xffffffce 0xffffffce 0xffffffce 0xffffffce 0xffffffce 0xffffffce 0xffffffce 0xffffffce 0xffffffce 0xffffffce 0xffffffce 0xffffffce 0xffffffce 0xffffffce 0xffffffce 0xffffffce 0xffffffce 0xffffffce 0xffffffce 0xffffffce 0xffffffce 0xffffffce 0xffffffce 0xffffffce 0xffffffce 0xffffffce 0xffffffce 0xffffffce 0xffffffce 0xffffffce 0xffffffce 0xffffffce 0xffffffce 0xffffffce 0xffffffce 0xffffffce 0xffffffce 0xffffffce 0xffffffce 0xffffffce 0xffffffce 0xffffffce 0xffffffce 0xffffffce 0xffffffce 0xffffffce 0xffffffce 0xffffffce 0xffffffce 0xffffffce 0xffffffce 0xffffffce 0xffffffce 0xffffffce 0xffffffce 0xffffffce 0xffffffce 0xffffffce 0xffffffce 0xffffffce 0xffffffce 0xffffffce 0xffffffce 0xffffffce 0xffffffce 0xffffffce 0xffffffce 0xffffffce 0xffffffce 0xffffffce 0xffffffce 0xffffffce 0xffffffce 0xffffffce 0xffffffce 0xffffffce 0xffffffce 0xffffffce 0xffffffce 0xffffffce 0xffffffce 0xffffffce 0xffffffce 0xffffffce 0xffffffce 0xffffffce 0xffffffce 0xffffffce 0xffffffce 0xffffffce 0xffffffce 0xffffffce 0xffffffce 0xffffffce 0xffffffce 0xffffffce 0xffffffce 0xffffffce 0xffffffce 0xffffffce 0xffffffce 0xffffffce 0xffffffce 0xffffffce 0xffffffce 0xffffffce 0xffffffce 0xffffffce 0xffffffce 0xffffffce 0xffffffce 0xffffffce 0xffffffce 0xffffffce 0xffffffce 0xffffffce 0xffffffce 0xffffffce 0xffffffce 0xffffffce 0xffffffce 0xffffffce 0xffffffce 0xffffffce 0xffffffce 0xffffffce 0xffffffce 0xffffffce 0xffffffce 0xffffffce 0xffffffce 0xffffffce 0xffffffce 0xffffffce 0xffffffce 0xffffffce 0xffffffce 0xffffffce 0xffffffce 0xffffffce 0xffffffce 0xffffffce 0xffffffce 0xffffffce 0xffffffce 0xffffffce 0xffffffce 0xffffffce 0xffffffce 0xffffffce 0xffffffce 0xffffffce 0xffffffce 0xffffffce 0xffffffce 0xffffffce 0xffffffce 0xffffffce 0xffffffce 0xffffffce 0xffffffce 0xffffffce 0xffffffce 0xffffffce 0xffffffce 0xffffffce 0xffffffce 0xffffffce 0xffffffce 0xffffffce 0xffffffce 0xffffffce 0xffffffce 0xffffffce 0xffffffce 0xffffffce 0xffffffce 0xffffffce 0xffffffce 0xffffffce 0xffffffce 0xffffffce 0xffffffce 0xffffffce 0xffffffce 0xffffffce 0xffffffce 0xffffffce 0xffffffce 0xffffffce 0xffffffce 0xffffffce 0xffffffce 0xffffffce 0xffffffce 0xffffffce 0xffffffce 0xffffffce 0xffffffce 0xffffffce 0xffffffce 0xffffffce 0xffffffce 0xffffffce 0xffffffce 0xffffffce 0xffffffce 0xffffffce 0xffffffce 0xffffffce 0xffffffce 0xffffffce 0xffffffce 0xffffffce 0xffffffce 0xffffffce 0xffffffce 0xffffffce 0xffffffce 0xffffffce 0xffffffce 0xffffffce 0xffffffce 0xffffffce 0xffffffce 0xffffffce 0xffffffce 0xffffffce 0xffffffce 0xffffffce 0xffffffce 0xffffffce 0xffffffce 0xffffffce 0xffffffce 0xffffffce 0xffffffce 0xffffffce 0xffffffce 0xffffffce 0xffffffce 0xffffffce 0xffffffce 0xffffffce 0xffffffce 0xffffffce 0xffffffce 0xffffffce 0xffffffce 0xffffffce 0xffffffce 0xffffffce 0xffffffce 0xffffffce 0xffffffce 0xffffffce 0xffffffce 0xffffffce 0xffffffce 0xffffffce 0xffffffce 0xffffffce 0xffffffce 0xffffffce 0xffffffce 0xffffffce 0xffffffce 0xffffffce 0xffffffce 0xffffffce 0xffffffce 0xffffffce 0xffffffce 0xffffffce 0xffffffce 0xffffffce 0xffffffce 0xffffffce 0xffffffce 0xffffffce 0xffffffce 0xffffffce 0xffffffce 0xffffffce 0xffffffce 0xffffffce 0xffffffce 0xffffffce 0xffffffce 0xffffffce 0xffffffce 0xffffffce 0xffffffce 0xffffffce 0xffffffce 0xffffffce 0xffffffce 0xffffffce 0xffffffce 0xffffffce 0xffffffce 0xffffffce 0xffffffce 0xffffffce 0xffffffce 0xffffffce 0xffffffce 0xffffffce 0xffffffce 0xffffffce 0xffffffce 0xffffffce 0xffffffce 0xffffffce 0xffffffce 0xffffffce 0xffffffce 0xffffffce 0xffffffce 0xffffffce 0xffffffce 0xffffffce 0xffffffce 0xffffffce 0xffffffce 0xffffffce 0xffffffce 0xffffffce 0xffffffce 0xffffffce 0xffffffce 0xffffffce 0xffffffce 0xffffffce 0xffffffce 0xffffffce 0xffffffce 0xffffffce 0xffffffce 0xffffffce 0xffffffce 0xffffffce 0xffffffce 0xffffffce 0xffffffce 0xffffffce 0xffffffce 0xffffffce 0xffffffce 0xffffffce 0xffffffce 0xffffffce 0xffffffce 0xffffffce 0xffffffce 0xffffffce 0xffffffce 0xffffffce 0xffffffce 0xffffffce 0xffffffce 0xffffffce 0xffffffce 0xffffffce 0xffffffce 0xffffffce 0xffffffce 0xffffffce 0xffffffce 0xffffffce 0xffffffce 0xffffffce 0xffffffce 0xffffffce 0xffffffce 0xffffffce 0xffffffce 0xffffffce 0xffffffce 0xffffffce 0xffffffce 0xffffffce 0xffffffce 0xffffffce 0xffffffce 0xffffffce 0xffffffce 0xffffffce 0xffffffce 0xffffffce 0xffffffce 0xffffffce 0xffffffce 0xffffffce 0xffffffce 0xffffffce 0xffffffce 0xffffffce 0xffffffce 0xffffffce 0xffffffce 0xffffffce 0xffffffce 0xffffffce 0xffffffce 0xffffffce 0xffffffce 0xffffffce 0xffffffce 0xffffffce 0xffffffce 0xffffffce 0xffffffce 0xffffffce 0xffffffce 0xffffffce 0xffffffce 0xffffffce 0xffffffce 0xffffffce 0xffffffce 0xffffffce 0xffffffce 0xffffffce 0xffffffce 0xffffffce 0xffffffce 0xffffffce 0xffffffce 0xffffffce 0xffffffce 0xffffffce 0xffffffce 0xffffffce 0xffffffce 0xffffffce 0xffffffce 0xffffffce 0xffffffce 0xffffffce 0xffffffce 0xffffffce 0xffffffce 0xffffffce 0xffffffce 0xffffffce 0xffffffce 0xffffffce 0xffffffce 0xffffffce 0xffffffce 0xffffffce 0xffffffce 0xffffffce 0xffffffce 0xffffffce 0xffffffce 0xffffffce 0xffffffce 0xffffffce 0xffffffce 0xffffffce 0xffffffce 0xffffffce 0xffffffb5 0xffffffb5 0xffffffb5>;
			PS_Config_Diff_Test_Frame = <0x32>;
		};

		novatek-mp-criteria-599F@0 {
			#address-cells = <0x01>;
			#size-cells = <0x00>;
			compatible = "novatek-mp-criteria-599F";
			IC_X_CFG_SIZE = <0x12>;
			IC_Y_CFG_SIZE = <0x20>;
			IC_KEY_CFG_SIZE = <0x04>;
			X_Channel = <0x12>;
			Y_Channel = <0x20>;
			AIN_X = <0x00 0x01 0x02 0x03 0x04 0x05 0x06 0x07 0x08 0x09 0x0a 0x0b 0x0c 0x0d 0x0e 0x0f 0x10 0x11>;
			AIN_Y = <0x00 0x01 0x02 0x03 0x04 0x05 0x06 0x07 0x08 0x09 0x0a 0x0b 0x0c 0x0d 0x0e 0x0f 0x10 0x11 0x12 0x13 0x14 0x15 0x16 0x17 0x18 0x19 0x1a 0x1b 0x1c 0x1d 0x1e 0x1f>;
			AIN_KEY = <0x00 0x01 0x02 0xff>;
			PS_Config_Lmt_Short_Rawdata_P = <0x36b8 0x36b8 0x36b8 0x36b8 0x36b8 0x36b8 0x36b8 0x36b8 0x36b8 0x36b8 0x36b8 0x36b8 0x36b8 0x36b8 0x36b8 0x36b8 0x36b8 0x36b8 0x36b8 0x36b8 0x36b8 0x36b8 0x36b8 0x36b8 0x36b8 0x36b8 0x36b8 0x36b8 0x36b8 0x36b8 0x36b8 0x36b8 0x36b8 0x36b8 0x36b8 0x36b8 0x36b8 0x36b8 0x36b8 0x36b8 0x36b8 0x36b8 0x36b8 0x36b8 0x36b8 0x36b8 0x36b8 0x36b8 0x36b8 0x36b8 0x36b8 0x36b8 0x36b8 0x36b8 0x36b8 0x36b8 0x36b8 0x36b8 0x36b8 0x36b8 0x36b8 0x36b8 0x36b8 0x36b8 0x36b8 0x36b8 0x36b8 0x36b8 0x36b8 0x36b8 0x36b8 0x36b8 0x36b8 0x36b8 0x36b8 0x36b8 0x36b8 0x36b8 0x36b8 0x36b8 0x36b8 0x36b8 0x36b8 0x36b8 0x36b8 0x36b8 0x36b8 0x36b8 0x36b8 0x36b8 0x36b8 0x36b8 0x36b8 0x36b8 0x36b8 0x36b8 0x36b8 0x36b8 0x36b8 0x36b8 0x36b8 0x36b8 0x36b8 0x36b8 0x36b8 0x36b8 0x36b8 0x36b8 0x36b8 0x36b8 0x36b8 0x36b8 0x36b8 0x36b8 0x36b8 0x36b8 0x36b8 0x36b8 0x36b8 0x36b8 0x36b8 0x36b8 0x36b8 0x36b8 0x36b8 0x36b8 0x36b8 0x36b8 0x36b8 0x36b8 0x36b8 0x36b8 0x36b8 0x36b8 0x36b8 0x36b8 0x36b8 0x36b8 0x36b8 0x36b8 0x36b8 0x36b8 0x36b8 0x36b8 0x36b8 0x36b8 0x36b8 0x36b8 0x36b8 0x36b8 0x36b8 0x36b8 0x36b8 0x36b8 0x36b8 0x36b8 0x36b8 0x36b8 0x36b8 0x36b8 0x36b8 0x36b8 0x36b8 0x36b8 0x36b8 0x36b8 0x36b8 0x36b8 0x36b8 0x36b8 0x36b8 0x36b8 0x36b8 0x36b8 0x36b8 0x36b8 0x36b8 0x36b8 0x36b8 0x36b8 0x36b8 0x36b8 0x36b8 0x36b8 0x36b8 0x36b8 0x36b8 0x36b8 0x36b8 0x36b8 0x36b8 0x36b8 0x36b8 0x36b8 0x36b8 0x36b8 0x36b8 0x36b8 0x36b8 0x36b8 0x36b8 0x36b8 0x36b8 0x36b8 0x36b8 0x36b8 0x36b8 0x36b8 0x36b8 0x36b8 0x36b8 0x36b8 0x36b8 0x36b8 0x36b8 0x36b8 0x36b8 0x36b8 0x36b8 0x36b8 0x36b8 0x36b8 0x36b8 0x36b8 0x36b8 0x36b8 0x36b8 0x36b8 0x36b8 0x36b8 0x36b8 0x36b8 0x36b8 0x36b8 0x36b8 0x36b8 0x36b8 0x36b8 0x36b8 0x36b8 0x36b8 0x36b8 0x36b8 0x36b8 0x36b8 0x36b8 0x36b8 0x36b8 0x36b8 0x36b8 0x36b8 0x36b8 0x36b8 0x36b8 0x36b8 0x36b8 0x36b8 0x36b8 0x36b8 0x36b8 0x36b8 0x36b8 0x36b8 0x36b8 0x36b8 0x36b8 0x36b8 0x36b8 0x36b8 0x36b8 0x36b8 0x36b8 0x36b8 0x36b8 0x36b8 0x36b8 0x36b8 0x36b8 0x36b8 0x36b8 0x36b8 0x36b8 0x36b8 0x36b8 0x36b8 0x36b8 0x36b8 0x36b8 0x36b8 0x36b8 0x36b8 0x36b8 0x36b8 0x36b8 0x36b8 0x36b8 0x36b8 0x36b8 0x36b8 0x36b8 0x36b8 0x36b8 0x36b8 0x36b8 0x36b8 0x36b8 0x36b8 0x36b8 0x36b8 0x36b8 0x36b8 0x36b8 0x36b8 0x36b8 0x36b8 0x36b8 0x36b8 0x36b8 0x36b8 0x36b8 0x36b8 0x36b8 0x36b8 0x36b8 0x36b8 0x36b8 0x36b8 0x36b8 0x36b8 0x36b8 0x36b8 0x36b8 0x36b8 0x36b8 0x36b8 0x36b8 0x36b8 0x36b8 0x36b8 0x36b8 0x36b8 0x36b8 0x36b8 0x36b8 0x36b8 0x36b8 0x36b8 0x36b8 0x36b8 0x36b8 0x36b8 0x36b8 0x36b8 0x36b8 0x36b8 0x36b8 0x36b8 0x36b8 0x36b8 0x36b8 0x36b8 0x36b8 0x36b8 0x36b8 0x36b8 0x36b8 0x36b8 0x36b8 0x36b8 0x36b8 0x36b8 0x36b8 0x36b8 0x36b8 0x36b8 0x36b8 0x36b8 0x36b8 0x36b8 0x36b8 0x36b8 0x36b8 0x36b8 0x36b8 0x36b8 0x36b8 0x36b8 0x36b8 0x36b8 0x36b8 0x36b8 0x36b8 0x36b8 0x36b8 0x36b8 0x36b8 0x36b8 0x36b8 0x36b8 0x36b8 0x36b8 0x36b8 0x36b8 0x36b8 0x36b8 0x36b8 0x36b8 0x36b8 0x36b8 0x36b8 0x36b8 0x36b8 0x36b8 0x36b8 0x36b8 0x36b8 0x36b8 0x36b8 0x36b8 0x36b8 0x36b8 0x36b8 0x36b8 0x36b8 0x36b8 0x36b8 0x36b8 0x36b8 0x36b8 0x36b8 0x36b8 0x36b8 0x36b8 0x36b8 0x36b8 0x36b8 0x36b8 0x36b8 0x36b8 0x36b8 0x36b8 0x36b8 0x36b8 0x36b8 0x36b8 0x36b8 0x36b8 0x36b8 0x36b8 0x36b8 0x36b8 0x36b8 0x36b8 0x36b8 0x36b8 0x36b8 0x36b8 0x36b8 0x36b8 0x36b8 0x36b8 0x36b8 0x36b8 0x36b8 0x36b8 0x36b8 0x36b8 0x36b8 0x36b8 0x36b8 0x36b8 0x36b8 0x36b8 0x36b8 0x36b8 0x36b8 0x36b8 0x36b8 0x36b8 0x36b8 0x36b8 0x36b8 0x36b8 0x36b8 0x36b8 0x36b8 0x36b8 0x36b8 0x36b8 0x36b8 0x36b8 0x36b8 0x36b8 0x36b8 0x36b8 0x36b8 0x36b8 0x36b8 0x36b8 0x36b8 0x36b8 0x36b8 0x36b8 0x36b8 0x36b8 0x36b8 0x36b8 0x36b8 0x36b8 0x36b8 0x36b8 0x36b8 0x36b8 0x36b8 0x36b8 0x36b8 0x36b8 0x36b8 0x36b8 0x36b8 0x36b8 0x36b8 0x36b8 0x36b8 0x36b8 0x36b8 0x36b8 0x36b8 0x36b8 0x36b8 0x36b8 0x36b8 0x36b8 0x36b8 0x36b8 0x36b8 0x36b8 0x36b8 0x36b8 0x36b8 0x36b8 0x36b8 0x36b8 0x36b8 0x36b8 0x36b8 0x36b8 0x36b8 0x36b8 0x36b8 0x36b8 0x36b8 0x36b8 0x36b8 0x36b8 0x36b8 0x36b8 0x36b8 0x36b8 0x36b8 0x36b8 0x36b8 0x36b8 0x36b8 0x36b8 0x36b8 0x36b8 0x36b8 0x36b8 0x36b8 0x36b8 0x36b8 0x36b8 0x36b8 0x36b8 0x36b8 0x36b8 0x36b8 0x36b8>;
			PS_Config_Lmt_Short_Rawdata_N = <0x2774 0x2774 0x2774 0x2774 0x2774 0x2774 0x2774 0x2774 0x2774 0x2774 0x2774 0x2774 0x2774 0x2774 0x2774 0x2774 0x2774 0x2774 0x2774 0x2774 0x2774 0x2774 0x2774 0x2774 0x2774 0x2774 0x2774 0x2774 0x2774 0x2774 0x2774 0x2774 0x2774 0x2774 0x2774 0x2774 0x2774 0x2774 0x2774 0x2774 0x2774 0x2774 0x2774 0x2774 0x2774 0x2774 0x2774 0x2774 0x2774 0x2774 0x2774 0x2774 0x2774 0x2774 0x2774 0x2774 0x2774 0x2774 0x2774 0x2774 0x2774 0x2774 0x2774 0x2774 0x2774 0x2774 0x2774 0x2774 0x2774 0x2774 0x2774 0x2774 0x2774 0x2774 0x2774 0x2774 0x2774 0x2774 0x2774 0x2774 0x2774 0x2774 0x2774 0x2774 0x2774 0x2774 0x2774 0x2774 0x2774 0x2774 0x2774 0x2774 0x2774 0x2774 0x2774 0x2774 0x2774 0x2774 0x2774 0x2774 0x2774 0x2774 0x2774 0x2774 0x2774 0x2774 0x2774 0x2774 0x2774 0x2774 0x2774 0x2774 0x2774 0x2774 0x2774 0x2774 0x2774 0x2774 0x2774 0x2774 0x2774 0x2774 0x2774 0x2774 0x2774 0x2774 0x2774 0x2774 0x2774 0x2774 0x2774 0x2774 0x2774 0x2774 0x2774 0x2774 0x2774 0x2774 0x2774 0x2774 0x2774 0x2774 0x2774 0x2774 0x2774 0x2774 0x2774 0x2774 0x2774 0x2774 0x2774 0x2774 0x2774 0x2774 0x2774 0x2774 0x2774 0x2774 0x2774 0x2774 0x2774 0x2774 0x2774 0x2774 0x2774 0x2774 0x2774 0x2774 0x2774 0x2774 0x2774 0x2774 0x2774 0x2774 0x2774 0x2774 0x2774 0x2774 0x2774 0x2774 0x2774 0x2774 0x2774 0x2774 0x2774 0x2774 0x2774 0x2774 0x2774 0x2774 0x2774 0x2774 0x2774 0x2774 0x2774 0x2774 0x2774 0x2774 0x2774 0x2774 0x2774 0x2774 0x2774 0x2774 0x2774 0x2774 0x2774 0x2774 0x2774 0x2774 0x2774 0x2774 0x2774 0x2774 0x2774 0x2774 0x2774 0x2774 0x2774 0x2774 0x2774 0x2774 0x2774 0x2774 0x2774 0x2774 0x2774 0x2774 0x2774 0x2774 0x2774 0x2774 0x2774 0x2774 0x2774 0x2774 0x2774 0x2774 0x2774 0x2774 0x2774 0x2774 0x2774 0x2774 0x2774 0x2774 0x2774 0x2774 0x2774 0x2774 0x2774 0x2774 0x2774 0x2774 0x2774 0x2774 0x2774 0x2774 0x2774 0x2774 0x2774 0x2774 0x2774 0x2774 0x2774 0x2774 0x2774 0x2774 0x2774 0x2774 0x2774 0x2774 0x2774 0x2774 0x2774 0x2774 0x2774 0x2774 0x2774 0x2774 0x2774 0x2774 0x2774 0x2774 0x2774 0x2774 0x2774 0x2774 0x2774 0x2774 0x2774 0x2774 0x2774 0x2774 0x2774 0x2774 0x2774 0x2774 0x2774 0x2774 0x2774 0x2774 0x2774 0x2774 0x2774 0x2774 0x2774 0x2774 0x2774 0x2774 0x2774 0x2774 0x2774 0x2774 0x2774 0x2774 0x2774 0x2774 0x2774 0x2774 0x2774 0x2774 0x2774 0x2774 0x2774 0x2774 0x2774 0x2774 0x2774 0x2774 0x2774 0x2774 0x2774 0x2774 0x2774 0x2774 0x2774 0x2774 0x2774 0x2774 0x2774 0x2774 0x2774 0x2774 0x2774 0x2774 0x2774 0x2774 0x2774 0x2774 0x2774 0x2774 0x2774 0x2774 0x2774 0x2774 0x2774 0x2774 0x2774 0x2774 0x2774 0x2774 0x2774 0x2774 0x2774 0x2774 0x2774 0x2774 0x2774 0x2774 0x2774 0x2774 0x2774 0x2774 0x2774 0x2774 0x2774 0x2774 0x2774 0x2774 0x2774 0x2774 0x2774 0x2774 0x2774 0x2774 0x2774 0x2774 0x2774 0x2774 0x2774 0x2774 0x2774 0x2774 0x2774 0x2774 0x2774 0x2774 0x2774 0x2774 0x2774 0x2774 0x2774 0x2774 0x2774 0x2774 0x2774 0x2774 0x2774 0x2774 0x2774 0x2774 0x2774 0x2774 0x2774 0x2774 0x2774 0x2774 0x2774 0x2774 0x2774 0x2774 0x2774 0x2774 0x2774 0x2774 0x2774 0x2774 0x2774 0x2774 0x2774 0x2774 0x2774 0x2774 0x2774 0x2774 0x2774 0x2774 0x2774 0x2774 0x2774 0x2774 0x2774 0x2774 0x2774 0x2774 0x2774 0x2774 0x2774 0x2774 0x2774 0x2774 0x2774 0x2774 0x2774 0x2774 0x2774 0x2774 0x2774 0x2774 0x2774 0x2774 0x2774 0x2774 0x2774 0x2774 0x2774 0x2774 0x2774 0x2774 0x2774 0x2774 0x2774 0x2774 0x2774 0x2774 0x2774 0x2774 0x2774 0x2774 0x2774 0x2774 0x2774 0x2774 0x2774 0x2774 0x2774 0x2774 0x2774 0x2774 0x2774 0x2774 0x2774 0x2774 0x2774 0x2774 0x2774 0x2774 0x2774 0x2774 0x2774 0x2774 0x2774 0x2774 0x2774 0x2774 0x2774 0x2774 0x2774 0x2774 0x2774 0x2774 0x2774 0x2774 0x2774 0x2774 0x2774 0x2774 0x2774 0x2774 0x2774 0x2774 0x2774 0x2774 0x2774 0x2774 0x2774 0x2774 0x2774 0x2774 0x2774 0x2774 0x2774 0x2774 0x2774 0x2774 0x2774 0x2774 0x2774 0x2774 0x2774 0x2774 0x2774 0x2774 0x2774 0x2774 0x2774 0x2774 0x2774 0x2774 0x2774 0x2774 0x2774 0x2774 0x2774 0x2774 0x2774 0x2774 0x2774 0x2774 0x2774 0x2774 0x2774 0x2774 0x2774 0x2774 0x2774 0x2774 0x2774 0x2774 0x2774 0x2774 0x2774 0x2774 0x2774 0x2774 0x2710 0x2710 0x2710>;
			PS_Config_Lmt_Open_Rawdata_P = <0xffff 0x914 0x8cf 0x89c 0x869 0x815 0x7b9 0x76f 0x72b 0x790 0x7d1 0x81b 0x86c 0x8a1 0x8c4 0x8f5 0x93e 0xffff 0x99f 0x969 0x942 0x921 0x8e6 0x8af 0x88e 0x864 0x85a 0x8ba 0x8c1 0x8e6 0x903 0x928 0x94b 0x95b 0x981 0x967 0x9e2 0x9a8 0x984 0x960 0x929 0x8f2 0x8ce 0x8a5 0x89d 0x8d1 0x8d1 0x8fb 0x911 0x93d 0x95b 0x96b 0x991 0x97d 0x9fa 0x9c2 0x99d 0x975 0x93b 0x903 0x8e4 0x8b9 0x8ac 0x8e4 0x8e7 0x910 0x928 0x94f 0x970 0x981 0x9ad 0x9a3 0xa1e 0x9e5 0x9bd 0x99c 0x960 0x925 0x905 0x8d9 0x8d1 0x976 0x97d 0x99c 0x9bb 0x9e0 0x9ff 0xa0f 0xa3d 0xa39 0xa4f 0xa10 0x9ea 0x9c7 0x98b 0x952 0x931 0x8ff 0x8fb 0x95e 0x95e 0x98a 0x9ab 0x9d4 0x9f8 0xa0c 0xa39 0xa44 0xa8e 0xa50 0xa22 0xa02 0x9c4 0x987 0x965 0x931 0x92f 0x946 0x94c 0x96c 0x98f 0x9b9 0x9d8 0x9ed 0xa1b 0xa32 0xadc 0xa9b 0xa6b 0xa49 0xa0d 0x9cd 0x9a6 0x979 0x970 0x9b5 0x9bc 0x9e2 0xa05 0xa30 0xa4b 0xa61 0xa8a 0xaa6 0xb09 0xac0 0xa8f 0xa6a 0xa30 0x9f0 0x9c4 0x998 0x98f 0xa1b 0xa1b 0xa49 0xa64 0xa94 0xab5 0xac2 0xaf0 0xb19 0xb47 0xafe 0xad0 0xaa7 0xa67 0xa2c 0x9ff 0x9d2 0x9c7 0x9d2 0x9d4 0x9fb 0xa1b 0xa45 0xa6b 0xa7d 0xaa7 0xadb 0xb6a 0xb1b 0xaed 0xac0 0xa83 0xa47 0xa1f 0x9f0 0x9e5 0xa37 0xa33 0xa60 0xa80 0xaae 0xad1 0xadf 0xb0b 0xb4f 0xbb7 0xb6a 0xb43 0xb13 0xad1 0xa92 0xa6e 0xa39 0xa2f 0xa4e 0xa49 0xa78 0xa94 0xabe 0xae1 0xaf4 0xb1d 0xb64 0xc19 0xbca 0xb9b 0xb75 0xb32 0xaf0 0xacd 0xa95 0xa91 0xaa9 0xab1 0xad5 0xafb 0xb27 0xb45 0xb59 0xb84 0xbca 0xc04 0xbb7 0xb89 0xb60 0xb1d 0xadb 0xab0 0xa7a 0xa6f 0xa96 0xa9d 0xac2 0xaea 0xb14 0xb37 0xb4f 0xb79 0xbcc 0xc9c 0xc4e 0xc1a 0xbf4 0xbb4 0xb6e 0xb48 0xb12 0xb08 0xad1 0xada 0xb06 0xb29 0xb55 0xb7b 0xb8b 0xbbc 0xc13 0xcdd 0xc95 0xc66 0xc38 0xbf4 0xbac 0xb80 0xb4c 0xb3e 0xb4f 0xb58 0xb82 0xba6 0xbd8 0xbfd 0xc13 0xc40 0xc8e 0xcfe 0xcad 0xc83 0xc58 0xc17 0xbd4 0xba6 0xb76 0xb60 0xbb8 0xbbc 0xbef 0xc15 0xc47 0xc6e 0xc83 0xcb3 0xd0a 0xd38 0xce2 0xcb7 0xc83 0xc40 0xbfa 0xbcc 0xb98 0xb89 0xb84 0xb8a 0xbb8 0xbde 0xc13 0xc35 0xc4b 0xc79 0xcc4 0xde8 0xd91 0xd65 0xd34 0xce8 0xca3 0xc7c 0xc47 0xc33 0xc3f 0xc4a 0xc72 0xc9a 0xccf 0xcf2 0xd0e 0xd3d 0xd93 0xdd6 0xd8a 0xd5f 0xd2b 0xce0 0xc9b 0xc6b 0xc36 0xc27 0xc5d 0xc66 0xc94 0xcbd 0xcef 0xd12 0xd2b 0xd58 0xda6 0xe40 0xdf9 0xdc4 0xd97 0xd55 0xd0a 0xcdb 0xca3 0xc93 0xca2 0xcb4 0xcde 0xd0a 0xd3b 0xd62 0xd7f 0xdb0 0xe03 0xe84 0xe3f 0xe0b 0xddc 0xd8f 0xd46 0xd0f 0xcd3 0xcc1 0xccd 0xcd6 0xd01 0xd2f 0xd5e 0xd86 0xda2 0xdcf 0xe22 0xeba 0xe7e 0xe45 0xe18 0xdd2 0xd83 0xd4a 0xd13 0xcfe 0xd0e 0xd16 0xd42 0xd65 0xd9b 0xdc5 0xdd9 0xe0b 0xe5f 0xf06 0xed9 0xea9 0xe73 0xe30 0xdea 0xdb4 0xd7e 0xd67 0xd3c 0xd47 0xd74 0xda1 0xdd7 0xe00 0xe1f 0xe50 0xea1 0xfb3 0xf92 0xf5b 0xf20 0xed5 0xe88 0xe54 0xe1d 0xe06 0xd88 0xd98 0xdc7 0xdf8 0xe32 0xe53 0xe71 0xea0 0xee8 0xfb2 0xf9d 0xf72 0xf35 0xeea 0xe9d 0xe69 0xe2b 0xe14 0xdce 0xdd7 0xe08 0xe35 0xe6f 0xe94 0xeb7 0xee4 0xf33 0xfd5 0xfd2 0xfa0 0xf66 0xf17 0xecc 0xe9a 0xe5c 0xe47 0xe29 0xe39 0xe63 0xea0 0xed2 0xef8 0xf1c 0xf4d 0xf9a 0x1064 0x1072 0x103d 0x1002 0xfb3 0xf5f 0xf27 0xee8 0xece 0xe5e 0xe70 0xe9d 0xed2 0xf07 0xf31 0xf57 0xf87 0xfd5 0xfc7 0x10e9 0x10bf 0x1088 0x1042 0xff8 0xfb8 0xf7e 0xf5f 0xec8 0xedf 0xf10 0xf3c 0xf73 0xf9e 0xfb9 0xfea 0xf2e 0xfb6 0x10d9 0x10a0 0x1060 0x1011 0xfc8 0xf88 0xf4f 0xf2a 0xecc 0xee8 0xf15 0xf49 0xf7a 0xfa4 0xfc6 0xff7 0xf53 0x1015 0x1157 0x1121 0x10de 0x1093 0x1044 0x1002 0xfcb 0xfa4 0xf1f 0xf31 0xf66 0xf97 0xfd2 0x1002 0x1022 0x1054 0xf92 0x1099 0x11a2 0x119d 0x1159 0x1108 0x10b9 0x107e 0x1049 0x1028 0xf66 0xf77 0xfa5 0xfd4 0x100c 0x103f 0x1065 0x1077 0x1005 0x1400 0x1400 0x1400>;
			PS_Config_Lmt_Open_Rawdata_N = <0xffff0001 0x3e4 0x3c7 0x3b0 0x39b 0x377 0x34f 0x32f 0x313 0x33e 0x359 0x379 0x39c 0x3b3 0x3c2 0x3d7 0x3f6 0xffff0001 0x41f 0x409 0x3f8 0x3e9 0x3d0 0x3b9 0x3aa 0x398 0x394 0x3be 0x3c1 0x3d0 0x3dd 0x3ec 0x3fb 0x403 0x413 0x407 0x43c 0x424 0x414 0x404 0x3ed 0x3d6 0x3c6 0x3b5 0x3b1 0x3c7 0x3c7 0x3d9 0x3e3 0x3f5 0x403 0x409 0x419 0x411 0x446 0x42e 0x41f 0x40d 0x3f5 0x3dd 0x3d0 0x3bd 0x3b8 0x3d0 0x3d1 0x3e2 0x3ec 0x3fd 0x40c 0x413 0x425 0x421 0x456 0x43d 0x42d 0x41e 0x404 0x3eb 0x3dd 0x3cb 0x3c7 0x40e 0x411 0x41e 0x42b 0x43c 0x449 0x44f 0x463 0x461 0x46b 0x450 0x440 0x431 0x417 0x3fe 0x3f1 0x3db 0x3d9 0x404 0x404 0x416 0x425 0x436 0x446 0x44e 0x461 0x466 0x486 0x46c 0x458 0x44a 0x430 0x415 0x407 0x3f1 0x3ef 0x3fa 0x3fc 0x40a 0x419 0x42b 0x438 0x441 0x455 0x45e 0x4a8 0x48b 0x477 0x469 0x44f 0x433 0x422 0x40f 0x40c 0x429 0x42c 0x43c 0x44b 0x45e 0x469 0x473 0x484 0x490 0x4bb 0x49c 0x487 0x476 0x45e 0x442 0x430 0x41c 0x419 0x455 0x455 0x469 0x474 0x488 0x497 0x49c 0x4b0 0x4c1 0x4d5 0x4b6 0x4a2 0x491 0x475 0x45c 0x449 0x436 0x431 0x436 0x436 0x447 0x455 0x467 0x477 0x47f 0x491 0x4a7 0x4e4 0x4c3 0x4af 0x49c 0x481 0x467 0x457 0x442 0x43d 0x461 0x45f 0x472 0x480 0x494 0x4a3 0x4a9 0x4bb 0x4d9 0x505 0x4e4 0x4d3 0x4bf 0x4a3 0x488 0x478 0x461 0x45d 0x46a 0x469 0x47c 0x488 0x49a 0x4a9 0x4b2 0x4c3 0x4e2 0x52f 0x50e 0x4f9 0x4e9 0x4cc 0x4b0 0x4a1 0x489 0x487 0x491 0x495 0x4a5 0x4b5 0x4c7 0x4d5 0x4dd 0x4f0 0x50e 0x526 0x505 0x4f1 0x4e0 0x4c3 0x4a7 0x494 0x47e 0x479 0x48a 0x48d 0x49c 0x4ae 0x4c0 0x4cf 0x4d9 0x4eb 0x50e 0x568 0x546 0x530 0x520 0x504 0x4e6 0x4d6 0x4be 0x4ba 0x4a3 0x4a6 0x4ba 0x4c9 0x4db 0x4eb 0x4f3 0x508 0x52d 0x583 0x565 0x550 0x53c 0x520 0x500 0x4ee 0x4d8 0x4d2 0x4d9 0x4dc 0x4ee 0x4fe 0x514 0x523 0x52d 0x540 0x562 0x592 0x56f 0x55d 0x54a 0x52f 0x512 0x4fe 0x4ea 0x4e0 0x506 0x508 0x51d 0x52d 0x543 0x554 0x55d 0x571 0x596 0x5aa 0x586 0x573 0x55d 0x540 0x522 0x50e 0x4f8 0x4f1 0x4f0 0x4f2 0x506 0x516 0x52d 0x53b 0x545 0x559 0x578 0x5f6 0x5d1 0x5bd 0x5a8 0x588 0x56b 0x55a 0x543 0x53b 0x53f 0x544 0x556 0x566 0x57d 0x58c 0x598 0x5ad 0x5d1 0x5ee 0x5ce 0x5bb 0x5a5 0x584 0x567 0x553 0x53c 0x535 0x54d 0x550 0x564 0x575 0x58b 0x59a 0x5a5 0x5b8 0x5da 0x61c 0x5fd 0x5e6 0x5d3 0x5b7 0x596 0x583 0x56b 0x563 0x56a 0x572 0x584 0x596 0x5ab 0x5bc 0x5c9 0x5de 0x601 0x638 0x61b 0x605 0x5f0 0x5cf 0x5b0 0x599 0x57f 0x577 0x57d 0x580 0x593 0x5a7 0x5ba 0x5cc 0x5d8 0x5eb 0x60e 0x650 0x636 0x61d 0x60a 0x5ec 0x5cb 0x5b2 0x59b 0x592 0x598 0x59c 0x5ae 0x5bd 0x5d5 0x5e7 0x5ef 0x605 0x629 0x670 0x65d 0x649 0x631 0x614 0x5f6 0x5e0 0x5c8 0x5bf 0x5ac 0x5b1 0x5c4 0x5d7 0x5ef 0x600 0x60d 0x622 0x645 0x6bb 0x6ac 0x695 0x67c 0x65b 0x63a 0x624 0x60d 0x602 0x5cc 0x5d4 0x5e7 0x5fc 0x616 0x623 0x631 0x644 0x664 0x6ba 0x6b1 0x69e 0x685 0x664 0x643 0x62d 0x613 0x608 0x5ea 0x5ef 0x604 0x617 0x62f 0x640 0x64f 0x662 0x683 0x6c9 0x6c8 0x6b2 0x69a 0x677 0x658 0x642 0x628 0x61f 0x611 0x619 0x62b 0x644 0x65a 0x66a 0x67a 0x68f 0x6b0 0x706 0x70c 0x6f5 0x6dc 0x6bb 0x697 0x67f 0x664 0x658 0x628 0x630 0x643 0x65a 0x671 0x683 0x693 0x6a7 0x6c9 0x6c3 0x73f 0x72d 0x716 0x6f8 0x6d8 0x6bc 0x6a4 0x697 0x656 0x65f 0x674 0x688 0x69f 0x6b2 0x6bd 0x6d2 0x682 0x6bc 0x739 0x720 0x704 0x6e3 0x6c4 0x6a8 0x68f 0x680 0x658 0x664 0x677 0x68d 0x6a2 0x6b4 0x6c2 0x6d7 0x691 0x6e5 0x76f 0x757 0x73a 0x71b 0x6f8 0x6dc 0x6c5 0x6b4 0x67b 0x683 0x69a 0x6af 0x6c8 0x6dc 0x6ea 0x700 0x6ac 0x71d 0x78e 0x78d 0x76f 0x74c 0x72b 0x712 0x6fb 0x6ec 0x69a 0x6a1 0x6b5 0x6c8 0x6e0 0x6f7 0x707 0x70f 0x6dd 0xfffffe01 0xfffffe01 0xfffffe01>;
			PS_Config_Lmt_FW_Rawdata_P = <0xffff 0x46b 0x455 0x453 0x44b 0x45c 0x44e 0x459 0x466 0x451 0x45d 0x453 0x464 0x452 0x456 0x447 0x46f 0xffff 0x47c 0x46f 0x458 0x451 0x46e 0x42e 0x46e 0x45c 0x44f 0x463 0x45d 0x45a 0x45a 0x459 0x460 0x451 0x455 0x45c 0x459 0x45f 0x45c 0x455 0x464 0x458 0x466 0x458 0x459 0x44b 0x458 0x468 0x455 0x46b 0x453 0x458 0x463 0x466 0x472 0x474 0x459 0x461 0x459 0x440 0x463 0x452 0x45a 0x44c 0x45a 0x464 0x461 0x461 0x456 0x456 0x463 0x45d 0x43a 0x467 0x45c 0x46a 0x456 0x453 0x444 0x468 0x46b 0x468 0x45f 0x44e 0x46d 0x440 0x44c 0x46d 0x451 0x460 0x45a 0x463 0x455 0x45a 0x46b 0x44b 0x461 0x46e 0x455 0x45c 0x468 0x451 0x45d 0x456 0x466 0x468 0x45d 0x456 0x45d 0x455 0x475 0x43d 0x467 0x456 0x456 0x46d 0x455 0x47b 0x448 0x448 0x460 0x456 0x46f 0x44c 0x45c 0x455 0x46f 0x44f 0x458 0x46a 0x43e 0x45d 0x453 0x46a 0x452 0x46e 0x458 0x447 0x466 0x45a 0x466 0x44e 0x45a 0x45c 0x42c 0x44b 0x472 0x458 0x464 0x441 0x46d 0x45d 0x459 0x460 0x44b 0x441 0x474 0x43e 0x483 0x445 0x437 0x489 0x461 0x459 0x45a 0x468 0x447 0x46e 0x44c 0x456 0x45f 0x474 0x448 0x453 0x453 0x46a 0x459 0x459 0x456 0x455 0x453 0x445 0x44e 0x471 0x44a 0x464 0x44f 0x460 0x45d 0x474 0x46d 0x435 0x46f 0x459 0x45c 0x463 0x461 0x43a 0x44a 0x448 0x46f 0x44e 0x46a 0x453 0x459 0x476 0x453 0x460 0x44b 0x45a 0x453 0x452 0x46e 0x445 0x471 0x467 0x472 0x42c 0x453 0x47b 0x445 0x468 0x45a 0x44e 0x466 0x45c 0x461 0x459 0x46f 0x455 0x474 0x43e 0x479 0x475 0x467 0x466 0x451 0x472 0x455 0x467 0x45c 0x440 0x463 0x46b 0x45d 0x453 0x45d 0x459 0x46b 0x455 0x471 0x471 0x471 0x452 0x44e 0x47c 0x444 0x478 0x447 0x463 0x471 0x458 0x45a 0x45f 0x46a 0x458 0x45a 0x458 0x45d 0x45a 0x45a 0x44f 0x44e 0x460 0x45d 0x459 0x46a 0x458 0x445 0x46e 0x444 0x45a 0x463 0x451 0x44f 0x466 0x44b 0x44f 0x44c 0x44a 0x467 0x44e 0x467 0x467 0x44e 0x45c 0x47f 0x46b 0x456 0x44a 0x46f 0x452 0x46a 0x460 0x463 0x44b 0x44a 0x456 0x472 0x456 0x46a 0x467 0x45f 0x45d 0x44e 0x466 0x452 0x461 0x458 0x46d 0x44e 0x463 0x43d 0x448 0x463 0x46a 0x458 0x466 0x461 0x444 0x475 0x43a 0x474 0x453 0x45a 0x447 0x46f 0x45a 0x474 0x444 0x478 0x455 0x443 0x455 0x474 0x44a 0x479 0x451 0x472 0x459 0x452 0x46b 0x447 0x47b 0x435 0x464 0x45a 0x45c 0x452 0x468 0x46b 0x467 0x451 0x458 0x464 0x45f 0x463 0x452 0x455 0x44e 0x464 0x456 0x464 0x460 0x46a 0x448 0x466 0x460 0x453 0x45a 0x44c 0x482 0x432 0x478 0x44c 0x47f 0x44f 0x43a 0x44f 0x44b 0x459 0x456 0x45f 0x452 0x464 0x468 0x464 0x458 0x461 0x452 0x46d 0x456 0x452 0x461 0x453 0x44e 0x476 0x444 0x46b 0x453 0x478 0x45f 0x44a 0x468 0x444 0x466 0x45c 0x46a 0x447 0x474 0x44c 0x455 0x472 0x464 0x464 0x464 0x448 0x46b 0x43e 0x447 0x468 0x463 0x47d 0x451 0x47b 0x453 0x46e 0x45c 0x456 0x460 0x435 0x455 0x466 0x456 0x46d 0x455 0x467 0x463 0x458 0x452 0x466 0x452 0x472 0x45d 0x44a 0x468 0x447 0x468 0x478 0x467 0x452 0x46f 0x458 0x452 0x464 0x46f 0x458 0x472 0x44e 0x45f 0x463 0x460 0x44f 0x479 0x44b 0x46b 0x467 0x471 0x44a 0x460 0x45d 0x451 0x463 0x46f 0x444 0x45c 0x46a 0x459 0x44a 0x460 0x461 0x45c 0x45c 0x45c 0x45d 0x467 0x45c 0x467 0x44e 0x467 0x46a 0x43d 0x466 0x45f 0x43e 0x455 0x44c 0x432 0x47b 0x464 0x455 0x45d 0x44b 0x472 0x44b 0x45d 0x460 0x44b 0x467 0x463 0x45a 0x467 0x466 0x47f 0x437 0x444 0x475 0x458 0x452 0x47f 0x474 0x44f 0x45d 0x45d 0x458 0x444 0x46e 0x472 0x44e 0x46e 0x455 0x45d 0x472 0x46f 0x46b 0x464 0x44c 0x45f 0x464 0x467 0x468 0x453 0x46b 0x468 0x441 0x448 0x468 0x460 0x458 0x464 0x47c 0x464 0x45c 0x448 0x45a 0x456 0x45c 0x447 0x448 0x46b 0x459 0x453 0x46b 0x460 0x461 0x461 0xf00 0xf00 0xf00>;
			PS_Config_Lmt_FW_Rawdata_N = <0xffff0001 0x1e5 0x1db 0x1db 0x1d7 0x1de 0x1d8 0x1dd 0x1e2 0x1d9 0x1df 0x1db 0x1e2 0x1da 0x1dc 0x1d5 0x1e7 0xffff0001 0x1ec 0x1e7 0x1dc 0x1d9 0x1e6 0x1ca 0x1e6 0x1de 0x1d9 0x1e1 0x1df 0x1de 0x1de 0x1dd 0x1e0 0x1d9 0x1db 0x1de 0x1dd 0x1df 0x1de 0x1db 0x1e2 0x1dc 0x1e2 0x1dc 0x1dd 0x1d7 0x1dc 0x1e4 0x1db 0x1e5 0x1db 0x1dc 0x1e1 0x1e2 0x1e8 0x1e8 0x1dd 0x1e1 0x1dd 0x1d2 0x1e1 0x1da 0x1de 0x1d8 0x1de 0x1e2 0x1e1 0x1e1 0x1dc 0x1dc 0x1e1 0x1df 0x1d0 0x1e3 0x1de 0x1e4 0x1dc 0x1db 0x1d4 0x1e4 0x1e5 0x1e4 0x1df 0x1d8 0x1e5 0x1d2 0x1d8 0x1e5 0x1d9 0x1e0 0x1de 0x1e1 0x1db 0x1de 0x1e5 0x1d7 0x1e1 0x1e6 0x1db 0x1de 0x1e4 0x1d9 0x1df 0x1dc 0x1e2 0x1e4 0x1df 0x1dc 0x1df 0x1db 0x1e9 0x1d1 0x1e3 0x1dc 0x1dc 0x1e5 0x1db 0x1eb 0x1d6 0x1d6 0x1e0 0x1dc 0x1e7 0x1d8 0x1de 0x1db 0x1e7 0x1d9 0x1dc 0x1e4 0x1d2 0x1df 0x1db 0x1e4 0x1da 0x1e6 0x1dc 0x1d5 0x1e2 0x1de 0x1e2 0x1d8 0x1de 0x1de 0x1ca 0x1d7 0x1e8 0x1dc 0x1e2 0x1d3 0x1e5 0x1df 0x1dd 0x1e0 0x1d7 0x1d3 0x1e8 0x1d2 0x1ef 0x1d5 0x1cf 0x1f1 0x1e1 0x1dd 0x1de 0x1e4 0x1d5 0x1e6 0x1d8 0x1dc 0x1df 0x1e8 0x1d6 0x1db 0x1db 0x1e4 0x1dd 0x1dd 0x1dc 0x1db 0x1db 0x1d5 0x1d8 0x1e7 0x1d6 0x1e2 0x1d9 0x1e0 0x1df 0x1e8 0x1e5 0x1cd 0x1e7 0x1dd 0x1de 0x1e1 0x1e1 0x1d0 0x1d6 0x1d6 0x1e7 0x1d8 0x1e4 0x1db 0x1dd 0x1ea 0x1db 0x1e0 0x1d7 0x1de 0x1db 0x1da 0x1e6 0x1d5 0x1e7 0x1e3 0x1e8 0x1ca 0x1db 0x1eb 0x1d5 0x1e4 0x1de 0x1d8 0x1e2 0x1de 0x1e1 0x1dd 0x1e7 0x1db 0x1e8 0x1d2 0x1eb 0x1e9 0x1e3 0x1e2 0x1d9 0x1e8 0x1db 0x1e3 0x1de 0x1d2 0x1e1 0x1e5 0x1df 0x1db 0x1df 0x1dd 0x1e5 0x1db 0x1e7 0x1e7 0x1e7 0x1da 0x1d8 0x1ec 0x1d4 0x1ea 0x1d5 0x1e1 0x1e7 0x1dc 0x1de 0x1df 0x1e4 0x1dc 0x1de 0x1dc 0x1df 0x1de 0x1de 0x1d9 0x1d8 0x1e0 0x1df 0x1dd 0x1e4 0x1dc 0x1d5 0x1e6 0x1d4 0x1de 0x1e1 0x1d9 0x1d9 0x1e2 0x1d7 0x1d9 0x1d8 0x1d6 0x1e3 0x1d8 0x1e3 0x1e3 0x1d8 0x1de 0x1ed 0x1e5 0x1dc 0x1d6 0x1e7 0x1da 0x1e4 0x1e0 0x1e1 0x1d7 0x1d6 0x1dc 0x1e8 0x1dc 0x1e4 0x1e3 0x1df 0x1df 0x1d8 0x1e2 0x1da 0x1e1 0x1dc 0x1e5 0x1d8 0x1e1 0x1d1 0x1d6 0x1e1 0x1e4 0x1dc 0x1e2 0x1e1 0x1d4 0x1e9 0x1d0 0x1e8 0x1db 0x1de 0x1d5 0x1e7 0x1de 0x1e8 0x1d4 0x1ea 0x1db 0x1d3 0x1db 0x1e8 0x1d6 0x1eb 0x1d9 0x1e8 0x1dd 0x1da 0x1e5 0x1d5 0x1eb 0x1cd 0x1e2 0x1de 0x1de 0x1da 0x1e4 0x1e5 0x1e3 0x1d9 0x1dc 0x1e2 0x1df 0x1e1 0x1da 0x1db 0x1d8 0x1e2 0x1dc 0x1e2 0x1e0 0x1e4 0x1d6 0x1e2 0x1e0 0x1db 0x1de 0x1d8 0x1ee 0x1cc 0x1ea 0x1d8 0x1ed 0x1d9 0x1d0 0x1d9 0x1d7 0x1dd 0x1dc 0x1df 0x1da 0x1e2 0x1e4 0x1e2 0x1dc 0x1e1 0x1da 0x1e5 0x1dc 0x1da 0x1e1 0x1db 0x1d8 0x1ea 0x1d4 0x1e5 0x1db 0x1ea 0x1df 0x1d6 0x1e4 0x1d4 0x1e2 0x1de 0x1e4 0x1d5 0x1e8 0x1d8 0x1db 0x1e8 0x1e2 0x1e2 0x1e2 0x1d6 0x1e5 0x1d2 0x1d5 0x1e4 0x1e1 0x1ed 0x1d9 0x1eb 0x1db 0x1e6 0x1de 0x1dc 0x1e0 0x1cd 0x1db 0x1e2 0x1dc 0x1e5 0x1db 0x1e3 0x1e1 0x1dc 0x1da 0x1e2 0x1da 0x1e8 0x1df 0x1d6 0x1e4 0x1d5 0x1e4 0x1ea 0x1e3 0x1da 0x1e7 0x1dc 0x1da 0x1e2 0x1e7 0x1dc 0x1e8 0x1d8 0x1df 0x1e1 0x1e0 0x1d9 0x1eb 0x1d7 0x1e5 0x1e3 0x1e7 0x1d6 0x1e0 0x1df 0x1d9 0x1e1 0x1e7 0x1d4 0x1de 0x1e4 0x1dd 0x1d6 0x1e0 0x1e1 0x1de 0x1de 0x1de 0x1df 0x1e3 0x1de 0x1e3 0x1d8 0x1e3 0x1e4 0x1d1 0x1e2 0x1df 0x1d2 0x1db 0x1d8 0x1cc 0x1eb 0x1e2 0x1db 0x1df 0x1d7 0x1e8 0x1d7 0x1df 0x1e0 0x1d7 0x1e3 0x1e1 0x1de 0x1e3 0x1e2 0x1ed 0x1cf 0x1d4 0x1e9 0x1dc 0x1da 0x1ed 0x1e8 0x1d9 0x1df 0x1df 0x1dc 0x1d4 0x1e6 0x1e8 0x1d8 0x1e6 0x1db 0x1df 0x1e8 0x1e7 0x1e5 0x1e2 0x1d8 0x1df 0x1e2 0x1e3 0x1e4 0x1db 0x1e5 0x1e4 0x1d3 0x1d6 0x1e4 0x1e0 0x1dc 0x1e2 0x1ec 0x1e2 0x1de 0x1d6 0x1de 0x1dc 0x1de 0x1d5 0x1d6 0x1e5 0x1dd 0x1db 0x1e5 0x1e0 0x1e1 0x1e1 0xf0 0xf0 0xf0>;
			PS_Config_Lmt_FW_CC_P = <0xffff 0x34 0x34 0x34 0x34 0x34 0x34 0x34 0x34 0x34 0x34 0x34 0x34 0x34 0x34 0x34 0x34 0xffff 0x34 0x34 0x34 0x34 0x34 0x34 0x34 0x34 0x34 0x34 0x34 0x34 0x34 0x34 0x34 0x34 0x34 0x34 0x34 0x34 0x34 0x34 0x34 0x34 0x34 0x34 0x34 0x34 0x34 0x34 0x34 0x34 0x34 0x34 0x34 0x34 0x34 0x34 0x34 0x34 0x34 0x34 0x34 0x34 0x34 0x34 0x34 0x34 0x34 0x34 0x34 0x34 0x34 0x34 0x34 0x34 0x34 0x34 0x34 0x34 0x34 0x34 0x34 0x34 0x34 0x34 0x34 0x34 0x34 0x34 0x34 0x34 0x34 0x34 0x34 0x34 0x34 0x34 0x34 0x34 0x34 0x34 0x34 0x34 0x34 0x34 0x34 0x34 0x34 0x34 0x34 0x34 0x34 0x34 0x34 0x34 0x34 0x34 0x34 0x34 0x34 0x34 0x34 0x34 0x34 0x34 0x34 0x34 0x34 0x34 0x34 0x34 0x34 0x34 0x34 0x34 0x34 0x34 0x34 0x34 0x34 0x34 0x34 0x34 0x34 0x34 0x34 0x34 0x34 0x34 0x34 0x34 0x34 0x34 0x34 0x34 0x34 0x34 0x34 0x34 0x34 0x34 0x34 0x34 0x34 0x34 0x34 0x34 0x34 0x34 0x34 0x34 0x34 0x34 0x34 0x34 0x34 0x34 0x34 0x34 0x34 0x34 0x34 0x34 0x34 0x34 0x34 0x34 0x34 0x34 0x34 0x34 0x34 0x34 0x34 0x34 0x34 0x34 0x34 0x34 0x34 0x34 0x34 0x34 0x34 0x34 0x34 0x34 0x34 0x34 0x34 0x34 0x34 0x34 0x34 0x34 0x34 0x34 0x34 0x34 0x34 0x34 0x34 0x34 0x34 0x34 0x34 0x34 0x34 0x34 0x34 0x34 0x34 0x34 0x34 0x34 0x34 0x34 0x34 0x34 0x34 0x34 0x34 0x34 0x34 0x34 0x34 0x34 0x34 0x34 0x34 0x34 0x34 0x34 0x34 0x34 0x34 0x34 0x34 0x34 0x34 0x34 0x34 0x34 0x34 0x34 0x34 0x34 0x34 0x34 0x34 0x34 0x34 0x34 0x34 0x34 0x34 0x34 0x34 0x34 0x34 0x34 0x34 0x34 0x34 0x34 0x34 0x34 0x34 0x34 0x34 0x34 0x34 0x34 0x34 0x34 0x34 0x34 0x34 0x34 0x34 0x34 0x34 0x34 0x34 0x34 0x34 0x34 0x34 0x34 0x34 0x34 0x34 0x34 0x34 0x34 0x34 0x34 0x34 0x34 0x34 0x34 0x34 0x34 0x34 0x34 0x34 0x34 0x34 0x34 0x34 0x34 0x34 0x34 0x34 0x34 0x34 0x34 0x34 0x34 0x34 0x34 0x34 0x34 0x34 0x34 0x34 0x34 0x34 0x34 0x34 0x34 0x34 0x34 0x34 0x34 0x34 0x34 0x34 0x34 0x34 0x34 0x34 0x34 0x34 0x34 0x34 0x34 0x34 0x34 0x34 0x34 0x34 0x34 0x34 0x34 0x34 0x34 0x34 0x34 0x34 0x34 0x34 0x34 0x34 0x34 0x34 0x34 0x34 0x34 0x34 0x34 0x34 0x34 0x34 0x34 0x34 0x34 0x34 0x34 0x34 0x34 0x34 0x34 0x34 0x34 0x34 0x34 0x34 0x34 0x34 0x34 0x34 0x34 0x34 0x34 0x34 0x34 0x34 0x34 0x34 0x34 0x34 0x34 0x34 0x34 0x34 0x34 0x34 0x34 0x34 0x34 0x34 0x34 0x34 0x34 0x34 0x34 0x34 0x34 0x34 0x34 0x34 0x34 0x34 0x34 0x34 0x34 0x34 0x34 0x34 0x34 0x34 0x34 0x34 0x34 0x34 0x34 0x34 0x34 0x34 0x34 0x34 0x34 0x34 0x34 0x34 0x34 0x34 0x34 0x34 0x34 0x34 0x34 0x34 0x34 0x34 0x34 0x34 0x34 0x34 0x34 0x34 0x34 0x34 0x34 0x34 0x34 0x34 0x34 0x34 0x34 0x34 0x34 0x34 0x34 0x34 0x34 0x34 0x34 0x34 0x34 0x34 0x34 0x34 0x34 0x34 0x34 0x34 0x34 0x34 0x34 0x34 0x34 0x34 0x34 0x34 0x34 0x34 0x34 0x34 0x34 0x34 0x34 0x34 0x34 0x34 0x34 0x34 0x34 0x34 0x34 0x34 0x34 0x34 0x34 0x34 0x34 0x34 0x34 0x34 0x34 0x34 0x34 0x34 0x34 0x34 0x34 0x34 0x34 0x34 0x34 0x34 0x34 0x34 0x34 0x34 0x34 0x34 0x34 0x34 0x34 0x34 0x34 0x34 0x34 0x34 0x34 0x34 0x34 0x34 0x34 0x34 0x34 0x34 0x34 0x34 0x34 0x13a 0x13a 0x13a>;
			PS_Config_Lmt_FW_CC_N = <0xffff0001 0x01 0x01 0x01 0x01 0x01 0x01 0x01 0x01 0x01 0x01 0x01 0x01 0x01 0x01 0x01 0x01 0xffff0001 0x01 0x01 0x01 0x01 0x01 0x01 0x01 0x01 0x01 0x01 0x01 0x01 0x01 0x01 0x01 0x01 0x01 0x01 0x01 0x01 0x01 0x01 0x01 0x01 0x01 0x01 0x01 0x01 0x01 0x01 0x01 0x01 0x01 0x01 0x01 0x01 0x01 0x01 0x01 0x01 0x01 0x01 0x01 0x01 0x01 0x01 0x01 0x01 0x01 0x01 0x01 0x01 0x01 0x01 0x01 0x01 0x01 0x01 0x01 0x01 0x01 0x01 0x01 0x01 0x01 0x01 0x01 0x01 0x01 0x01 0x01 0x01 0x01 0x01 0x01 0x01 0x01 0x01 0x01 0x01 0x01 0x01 0x01 0x01 0x01 0x01 0x01 0x01 0x01 0x01 0x01 0x01 0x01 0x01 0x01 0x01 0x01 0x01 0x01 0x01 0x01 0x01 0x01 0x01 0x01 0x01 0x01 0x01 0x01 0x01 0x01 0x01 0x01 0x01 0x01 0x01 0x01 0x01 0x01 0x01 0x01 0x01 0x01 0x01 0x01 0x01 0x01 0x01 0x01 0x01 0x01 0x01 0x01 0x01 0x01 0x01 0x01 0x01 0x01 0x01 0x01 0x01 0x01 0x01 0x01 0x01 0x01 0x01 0x01 0x01 0x01 0x01 0x01 0x01 0x01 0x01 0x01 0x01 0x01 0x01 0x01 0x01 0x01 0x01 0x01 0x01 0x01 0x01 0x01 0x01 0x01 0x01 0x01 0x01 0x01 0x01 0x01 0x01 0x01 0x01 0x01 0x01 0x01 0x01 0x01 0x01 0x01 0x01 0x01 0x01 0x01 0x01 0x01 0x01 0x01 0x01 0x01 0x01 0x01 0x01 0x01 0x01 0x01 0x01 0x01 0x01 0x01 0x01 0x01 0x01 0x01 0x01 0x01 0x01 0x01 0x01 0x01 0x01 0x01 0x01 0x01 0x01 0x01 0x01 0x01 0x01 0x01 0x01 0x01 0x01 0x01 0x01 0x01 0x01 0x01 0x01 0x01 0x01 0x01 0x01 0x01 0x01 0x01 0x01 0x01 0x01 0x01 0x01 0x01 0x01 0x01 0x01 0x01 0x01 0x01 0x01 0x01 0x01 0x01 0x01 0x01 0x01 0x01 0x01 0x01 0x01 0x01 0x01 0x01 0x01 0x01 0x01 0x01 0x01 0x01 0x01 0x01 0x01 0x01 0x01 0x01 0x01 0x01 0x01 0x01 0x01 0x01 0x01 0x01 0x01 0x01 0x01 0x01 0x01 0x01 0x01 0x01 0x01 0x01 0x01 0x01 0x01 0x01 0x01 0x01 0x01 0x01 0x01 0x01 0x01 0x01 0x01 0x01 0x01 0x01 0x01 0x01 0x01 0x01 0x01 0x01 0x01 0x01 0x01 0x01 0x01 0x01 0x01 0x01 0x01 0x01 0x01 0x01 0x01 0x01 0x01 0x01 0x01 0x01 0x01 0x01 0x01 0x01 0x01 0x01 0x01 0x01 0x01 0x01 0x01 0x01 0x01 0x01 0x01 0x01 0x01 0x01 0x01 0x01 0x01 0x01 0x01 0x01 0x01 0x01 0x01 0x01 0x01 0x01 0x01 0x01 0x01 0x01 0x01 0x01 0x01 0x01 0x01 0x01 0x01 0x01 0x01 0x01 0x01 0x01 0x01 0x01 0x01 0x01 0x01 0x01 0x01 0x01 0x01 0x01 0x01 0x01 0x01 0x01 0x01 0x01 0x01 0x01 0x01 0x01 0x01 0x01 0x01 0x01 0x01 0x01 0x01 0x01 0x01 0x01 0x01 0x01 0x01 0x01 0x01 0x01 0x01 0x01 0x01 0x01 0x01 0x01 0x01 0x01 0x01 0x01 0x01 0x01 0x01 0x01 0x01 0x01 0x01 0x01 0x01 0x01 0x01 0x01 0x01 0x01 0x01 0x01 0x01 0x01 0x01 0x01 0x01 0x01 0x01 0x01 0x01 0x01 0x01 0x01 0x01 0x01 0x01 0x01 0x01 0x01 0x01 0x01 0x01 0x01 0x01 0x01 0x01 0x01 0x01 0x01 0x01 0x01 0x01 0x01 0x01 0x01 0x01 0x01 0x01 0x01 0x01 0x01 0x01 0x01 0x01 0x01 0x01 0x01 0x01 0x01 0x01 0x01 0x01 0x01 0x01 0x01 0x01 0x01 0x01 0x01 0x01 0x01 0x01 0x01 0x01 0x01 0x01 0x01 0x01 0x01 0x01 0x01 0x01 0x01 0x01 0x01 0x01 0x01 0x01 0x01 0x01 0x01 0x01 0x01 0x01 0x01 0x01 0x01 0x01 0x01 0x01 0x01 0x01 0x01 0x01 0x01 0x01 0x01 0x01 0x01 0x01 0x01 0x01 0x01 0x01 0x01 0x01 0x01 0x01 0x01 0x01 0x01 0x01 0x00 0x00 0x00>;
			PS_Config_Lmt_FW_Diff_P = <0xffff 0x32 0x32 0x32 0x32 0x32 0x32 0x32 0x32 0x32 0x32 0x32 0x32 0x32 0x32 0x32 0x32 0xffff 0x32 0x32 0x32 0x32 0x32 0x32 0x32 0x32 0x32 0x32 0x32 0x32 0x32 0x32 0x32 0x32 0x32 0x32 0x32 0x32 0x32 0x32 0x32 0x32 0x32 0x32 0x32 0x32 0x32 0x32 0x32 0x32 0x32 0x32 0x32 0x32 0x32 0x32 0x32 0x32 0x32 0x32 0x32 0x32 0x32 0x32 0x32 0x32 0x32 0x32 0x32 0x32 0x32 0x32 0x32 0x32 0x32 0x32 0x32 0x32 0x32 0x32 0x32 0x32 0x32 0x32 0x32 0x32 0x32 0x32 0x32 0x32 0x32 0x32 0x32 0x32 0x32 0x32 0x32 0x32 0x32 0x32 0x32 0x32 0x32 0x32 0x32 0x32 0x32 0x32 0x32 0x32 0x32 0x32 0x32 0x32 0x32 0x32 0x32 0x32 0x32 0x32 0x32 0x32 0x32 0x32 0x32 0x32 0x32 0x32 0x32 0x32 0x32 0x32 0x32 0x32 0x32 0x32 0x32 0x32 0x32 0x32 0x32 0x32 0x32 0x32 0x32 0x32 0x32 0x32 0x32 0x32 0x32 0x32 0x32 0x32 0x32 0x32 0x32 0x32 0x32 0x32 0x32 0x32 0x32 0x32 0x32 0x32 0x32 0x32 0x32 0x32 0x32 0x32 0x32 0x32 0x32 0x32 0x32 0x32 0x32 0x32 0x32 0x32 0x32 0x32 0x32 0x32 0x32 0x32 0x32 0x32 0x32 0x32 0x32 0x32 0x32 0x32 0x32 0x32 0x32 0x32 0x32 0x32 0x32 0x32 0x32 0x32 0x32 0x32 0x32 0x32 0x32 0x32 0x32 0x32 0x32 0x32 0x32 0x32 0x32 0x32 0x32 0x32 0x32 0x32 0x32 0x32 0x32 0x32 0x32 0x32 0x32 0x32 0x32 0x32 0x32 0x32 0x32 0x32 0x32 0x32 0x32 0x32 0x32 0x32 0x32 0x32 0x32 0x32 0x32 0x32 0x32 0x32 0x32 0x32 0x32 0x32 0x32 0x32 0x32 0x32 0x32 0x32 0x32 0x32 0x32 0x32 0x32 0x32 0x32 0x32 0x32 0x32 0x32 0x32 0x32 0x32 0x32 0x32 0x32 0x32 0x32 0x32 0x32 0x32 0x32 0x32 0x32 0x32 0x32 0x32 0x32 0x32 0x32 0x32 0x32 0x32 0x32 0x32 0x32 0x32 0x32 0x32 0x32 0x32 0x32 0x32 0x32 0x32 0x32 0x32 0x32 0x32 0x32 0x32 0x32 0x32 0x32 0x32 0x32 0x32 0x32 0x32 0x32 0x32 0x32 0x32 0x32 0x32 0x32 0x32 0x32 0x32 0x32 0x32 0x32 0x32 0x32 0x32 0x32 0x32 0x32 0x32 0x32 0x32 0x32 0x32 0x32 0x32 0x32 0x32 0x32 0x32 0x32 0x32 0x32 0x32 0x32 0x32 0x32 0x32 0x32 0x32 0x32 0x32 0x32 0x32 0x32 0x32 0x32 0x32 0x32 0x32 0x32 0x32 0x32 0x32 0x32 0x32 0x32 0x32 0x32 0x32 0x32 0x32 0x32 0x32 0x32 0x32 0x32 0x32 0x32 0x32 0x32 0x32 0x32 0x32 0x32 0x32 0x32 0x32 0x32 0x32 0x32 0x32 0x32 0x32 0x32 0x32 0x32 0x32 0x32 0x32 0x32 0x32 0x32 0x32 0x32 0x32 0x32 0x32 0x32 0x32 0x32 0x32 0x32 0x32 0x32 0x32 0x32 0x32 0x32 0x32 0x32 0x32 0x32 0x32 0x32 0x32 0x32 0x32 0x32 0x32 0x32 0x32 0x32 0x32 0x32 0x32 0x32 0x32 0x32 0x32 0x32 0x32 0x32 0x32 0x32 0x32 0x32 0x32 0x32 0x32 0x32 0x32 0x32 0x32 0x32 0x32 0x32 0x32 0x32 0x32 0x32 0x32 0x32 0x32 0x32 0x32 0x32 0x32 0x32 0x32 0x32 0x32 0x32 0x32 0x32 0x32 0x32 0x32 0x32 0x32 0x32 0x32 0x32 0x32 0x32 0x32 0x32 0x32 0x32 0x32 0x32 0x32 0x32 0x32 0x32 0x32 0x32 0x32 0x32 0x32 0x32 0x32 0x32 0x32 0x32 0x32 0x32 0x32 0x32 0x32 0x32 0x32 0x32 0x32 0x32 0x32 0x32 0x32 0x32 0x32 0x32 0x32 0x32 0x32 0x32 0x32 0x32 0x32 0x32 0x32 0x32 0x32 0x32 0x32 0x32 0x32 0x32 0x32 0x32 0x32 0x32 0x32 0x32 0x32 0x32 0x32 0x32 0x32 0x32 0x32 0x32 0x32 0x32 0x32 0x32 0x32 0x32 0x32 0x32 0x32 0x32 0x32 0x32 0x32 0x4b 0x4b 0x4b>;
			PS_Config_Lmt_FW_Diff_N = <0xffff0001 0xffffffce 0xffffffce 0xffffffce 0xffffffce 0xffffffce 0xffffffce 0xffffffce 0xffffffce 0xffffffce 0xffffffce 0xffffffce 0xffffffce 0xffffffce 0xffffffce 0xffffffce 0xffffffce 0xffff0001 0xffffffce 0xffffffce 0xffffffce 0xffffffce 0xffffffce 0xffffffce 0xffffffce 0xffffffce 0xffffffce 0xffffffce 0xffffffce 0xffffffce 0xffffffce 0xffffffce 0xffffffce 0xffffffce 0xffffffce 0xffffffce 0xffffffce 0xffffffce 0xffffffce 0xffffffce 0xffffffce 0xffffffce 0xffffffce 0xffffffce 0xffffffce 0xffffffce 0xffffffce 0xffffffce 0xffffffce 0xffffffce 0xffffffce 0xffffffce 0xffffffce 0xffffffce 0xffffffce 0xffffffce 0xffffffce 0xffffffce 0xffffffce 0xffffffce 0xffffffce 0xffffffce 0xffffffce 0xffffffce 0xffffffce 0xffffffce 0xffffffce 0xffffffce 0xffffffce 0xffffffce 0xffffffce 0xffffffce 0xffffffce 0xffffffce 0xffffffce 0xffffffce 0xffffffce 0xffffffce 0xffffffce 0xffffffce 0xffffffce 0xffffffce 0xffffffce 0xffffffce 0xffffffce 0xffffffce 0xffffffce 0xffffffce 0xffffffce 0xffffffce 0xffffffce 0xffffffce 0xffffffce 0xffffffce 0xffffffce 0xffffffce 0xffffffce 0xffffffce 0xffffffce 0xffffffce 0xffffffce 0xffffffce 0xffffffce 0xffffffce 0xffffffce 0xffffffce 0xffffffce 0xffffffce 0xffffffce 0xffffffce 0xffffffce 0xffffffce 0xffffffce 0xffffffce 0xffffffce 0xffffffce 0xffffffce 0xffffffce 0xffffffce 0xffffffce 0xffffffce 0xffffffce 0xffffffce 0xffffffce 0xffffffce 0xffffffce 0xffffffce 0xffffffce 0xffffffce 0xffffffce 0xffffffce 0xffffffce 0xffffffce 0xffffffce 0xffffffce 0xffffffce 0xffffffce 0xffffffce 0xffffffce 0xffffffce 0xffffffce 0xffffffce 0xffffffce 0xffffffce 0xffffffce 0xffffffce 0xffffffce 0xffffffce 0xffffffce 0xffffffce 0xffffffce 0xffffffce 0xffffffce 0xffffffce 0xffffffce 0xffffffce 0xffffffce 0xffffffce 0xffffffce 0xffffffce 0xffffffce 0xffffffce 0xffffffce 0xffffffce 0xffffffce 0xffffffce 0xffffffce 0xffffffce 0xffffffce 0xffffffce 0xffffffce 0xffffffce 0xffffffce 0xffffffce 0xffffffce 0xffffffce 0xffffffce 0xffffffce 0xffffffce 0xffffffce 0xffffffce 0xffffffce 0xffffffce 0xffffffce 0xffffffce 0xffffffce 0xffffffce 0xffffffce 0xffffffce 0xffffffce 0xffffffce 0xffffffce 0xffffffce 0xffffffce 0xffffffce 0xffffffce 0xffffffce 0xffffffce 0xffffffce 0xffffffce 0xffffffce 0xffffffce 0xffffffce 0xffffffce 0xffffffce 0xffffffce 0xffffffce 0xffffffce 0xffffffce 0xffffffce 0xffffffce 0xffffffce 0xffffffce 0xffffffce 0xffffffce 0xffffffce 0xffffffce 0xffffffce 0xffffffce 0xffffffce 0xffffffce 0xffffffce 0xffffffce 0xffffffce 0xffffffce 0xffffffce 0xffffffce 0xffffffce 0xffffffce 0xffffffce 0xffffffce 0xffffffce 0xffffffce 0xffffffce 0xffffffce 0xffffffce 0xffffffce 0xffffffce 0xffffffce 0xffffffce 0xffffffce 0xffffffce 0xffffffce 0xffffffce 0xffffffce 0xffffffce 0xffffffce 0xffffffce 0xffffffce 0xffffffce 0xffffffce 0xffffffce 0xffffffce 0xffffffce 0xffffffce 0xffffffce 0xffffffce 0xffffffce 0xffffffce 0xffffffce 0xffffffce 0xffffffce 0xffffffce 0xffffffce 0xffffffce 0xffffffce 0xffffffce 0xffffffce 0xffffffce 0xffffffce 0xffffffce 0xffffffce 0xffffffce 0xffffffce 0xffffffce 0xffffffce 0xffffffce 0xffffffce 0xffffffce 0xffffffce 0xffffffce 0xffffffce 0xffffffce 0xffffffce 0xffffffce 0xffffffce 0xffffffce 0xffffffce 0xffffffce 0xffffffce 0xffffffce 0xffffffce 0xffffffce 0xffffffce 0xffffffce 0xffffffce 0xffffffce 0xffffffce 0xffffffce 0xffffffce 0xffffffce 0xffffffce 0xffffffce 0xffffffce 0xffffffce 0xffffffce 0xffffffce 0xffffffce 0xffffffce 0xffffffce 0xffffffce 0xffffffce 0xffffffce 0xffffffce 0xffffffce 0xffffffce 0xffffffce 0xffffffce 0xffffffce 0xffffffce 0xffffffce 0xffffffce 0xffffffce 0xffffffce 0xffffffce 0xffffffce 0xffffffce 0xffffffce 0xffffffce 0xffffffce 0xffffffce 0xffffffce 0xffffffce 0xffffffce 0xffffffce 0xffffffce 0xffffffce 0xffffffce 0xffffffce 0xffffffce 0xffffffce 0xffffffce 0xffffffce 0xffffffce 0xffffffce 0xffffffce 0xffffffce 0xffffffce 0xffffffce 0xffffffce 0xffffffce 0xffffffce 0xffffffce 0xffffffce 0xffffffce 0xffffffce 0xffffffce 0xffffffce 0xffffffce 0xffffffce 0xffffffce 0xffffffce 0xffffffce 0xffffffce 0xffffffce 0xffffffce 0xffffffce 0xffffffce 0xffffffce 0xffffffce 0xffffffce 0xffffffce 0xffffffce 0xffffffce 0xffffffce 0xffffffce 0xffffffce 0xffffffce 0xffffffce 0xffffffce 0xffffffce 0xffffffce 0xffffffce 0xffffffce 0xffffffce 0xffffffce 0xffffffce 0xffffffce 0xffffffce 0xffffffce 0xffffffce 0xffffffce 0xffffffce 0xffffffce 0xffffffce 0xffffffce 0xffffffce 0xffffffce 0xffffffce 0xffffffce 0xffffffce 0xffffffce 0xffffffce 0xffffffce 0xffffffce 0xffffffce 0xffffffce 0xffffffce 0xffffffce 0xffffffce 0xffffffce 0xffffffce 0xffffffce 0xffffffce 0xffffffce 0xffffffce 0xffffffce 0xffffffce 0xffffffce 0xffffffce 0xffffffce 0xffffffce 0xffffffce 0xffffffce 0xffffffce 0xffffffce 0xffffffce 0xffffffce 0xffffffce 0xffffffce 0xffffffce 0xffffffce 0xffffffce 0xffffffce 0xffffffce 0xffffffce 0xffffffce 0xffffffce 0xffffffce 0xffffffce 0xffffffce 0xffffffce 0xffffffce 0xffffffce 0xffffffce 0xffffffce 0xffffffce 0xffffffce 0xffffffce 0xffffffce 0xffffffce 0xffffffce 0xffffffce 0xffffffce 0xffffffce 0xffffffce 0xffffffce 0xffffffce 0xffffffce 0xffffffce 0xffffffce 0xffffffce 0xffffffce 0xffffffce 0xffffffce 0xffffffce 0xffffffce 0xffffffce 0xffffffce 0xffffffce 0xffffffce 0xffffffce 0xffffffce 0xffffffce 0xffffffce 0xffffffce 0xffffffce 0xffffffce 0xffffffce 0xffffffce 0xffffffce 0xffffffce 0xffffffce 0xffffffce 0xffffffce 0xffffffce 0xffffffce 0xffffffce 0xffffffce 0xffffffce 0xffffffce 0xffffffce 0xffffffce 0xffffffce 0xffffffce 0xffffffce 0xffffffce 0xffffffce 0xffffffce 0xffffffce 0xffffffce 0xffffffce 0xffffffce 0xffffffce 0xffffffce 0xffffffce 0xffffffce 0xffffffce 0xffffffce 0xffffffce 0xffffffce 0xffffffce 0xffffffce 0xffffffce 0xffffffce 0xffffffce 0xffffffce 0xffffffce 0xffffffce 0xffffffce 0xffffffce 0xffffffce 0xffffffce 0xffffffce 0xffffffce 0xffffffce 0xffffffce 0xffffffce 0xffffffce 0xffffffce 0xffffffce 0xffffffce 0xffffffce 0xffffffce 0xffffffce 0xffffffce 0xffffffce 0xffffffce 0xffffffce 0xffffffce 0xffffffce 0xffffffce 0xffffffce 0xffffffce 0xffffffce 0xffffffce 0xffffffce 0xffffffce 0xffffffce 0xffffffce 0xffffffce 0xffffffce 0xffffffce 0xffffffce 0xffffffce 0xffffffce 0xffffffce 0xffffffce 0xffffffce 0xffffffce 0xffffffce 0xffffffce 0xffffffce 0xffffffce 0xffffffce 0xffffffce 0xffffffce 0xffffffce 0xffffffce 0xffffffce 0xffffffce 0xffffffce 0xffffffce 0xffffffce 0xffffffce 0xffffffce 0xffffffb5 0xffffffb5 0xffffffb5>;
			PS_Config_Diff_Test_Frame = <0x32>;
		};
	
	};
};
